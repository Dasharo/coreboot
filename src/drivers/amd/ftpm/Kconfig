## src/drivers/amd/ftpm/Kconfig
```kconfig
## SPDX-License-Identifier: GPL-2.0-only

config AMD_CRB_FTPM
	bool
	default n
	depends on !CRB_TPM
	depends on SOC_AMD_COMMON_BLOCK_PSP
	# The fTPM needs to access the SPI flash, either directly when
	# ROM Armor is used, or via PSP SMI when ROM Armor is not used.
	depends on SOC_AMD_COMMON_BLOCK_PSP_SMI || SOC_AMD_COMMON_BLOCK_PSP_ROM_ARMOR3
	help
	  Mainboard has AMD fTPM with Command Response Buffer support.
	  The fTPM is based on the CRB interface as defined by TCG,
	  but with reduced set of registers being implemented.

config AMD_CRB_FTPM_CMD_TIMEOUT_MS
	int
	default 60000 if HUDSON_PSP_FTPM
	default 3500
	depends on AMD_CRB_FTPM
	help
	  Time in milliseconds to wait for the fTPM to complete a command. The
	  Family 16h Model 30h fTPM has been seen to take over 30 seconds for a
	  single command while it does background work after startup.
```

## src/drivers/vpd/Kconfig
```kconfig
## SPDX-License-Identifier: GPL-2.0-only

config VPD
	bool "Support for Vital Product Data tables"
	default n
	help
	  Enable support for flash based vital product data.

config VPD_FMAP_NAME
	string
	depends on VPD
	default "RO_VPD"
	help
	  Name of the FMAP region created in the default FMAP to store VPD tables.

config VPD_FMAP_SIZE
	hex
	depends on VPD
	default 0x4000
	help
	  Size in bytes of the FMAP region created to store VPD tables.

config SMBIOS_SERIAL_FROM_VPD
	bool "Load device serial from VPD"
	depends on VPD && GENERATE_SMBIOS_TABLES
	default n
	help
	  Read the SMBIOS system serial number (type 1) from the
	  "serial_number" key and the baseboard serial number (type 2) from
	  the "mlb_serial_number" key in RO_VPD. The baseboard serial falls
	  back to "serial_number". Either one falls back to the Type2SN EFI
	  variable, then to MAINBOARD_SERIAL_NUMBER.

	  Mutually exclusive with DRIVERS_GENERIC_CBFS_SERIAL.

config SMBIOS_UUID_FROM_VPD
	bool "Load system UUID from VPD"
	depends on VPD && GENERATE_SMBIOS_TABLES
	default n
	help
	  Read the SMBIOS system UUID (type 1) from the "system_uuid" key
	  in RO_VPD, as a canonical 36-character UUID string. Falls back to
	  the Type1UUID EFI variable.

	  Mutually exclusive with DRIVERS_GENERIC_CBFS_UUID.
```
