## src/mainboard/clevo/nv4x/Kconfig.name
```kconfig
comment "NV4x"

config BOARD_CLEVO_NV41MB
	bool "NV41MB / NV41MB"

config BOARD_CLEVO_NV41ME
	bool "NV41ME / NV41ME"

config BOARD_CLEVO_NV41MZ
	bool "NV41MZ / NV41MZ"
```

## src/mainboard/clevo/tgl-u/Kconfig
```kconfig
config BOARD_CLEVO_TGLU_COMMON
	def_bool n
	select BOARD_ROMSIZE_KB_16384
	select DRIVERS_I2C_HID
	select DRIVERS_INTEL_PMC
	select DRIVERS_INTEL_USB4_RETIMER
	select HAVE_ACPI_TABLES
	select HAVE_ACPI_RESUME
	select HAVE_CMOS_DEFAULT
	select HAVE_OPTION_TABLE
	select INTEL_GMA_HAVE_VBT
	select INTEL_LPSS_UART_FOR_CONSOLE
	select MEMORY_MAPPED_TPM
	select MAINBOARD_HAS_TPM2
	select NO_UART_ON_SUPERIO
	select SOC_INTEL_COMMON_BLOCK_HDA_VERB
	select SOC_INTEL_ENABLE_USB4_PCIE_RESOURCES
	select SOC_INTEL_TIGERLAKE
	select SPD_READ_BY_WORD
	select SYSTEM_TYPE_LAPTOP
	select EC_SYSTEM76_EC
	select EC_SYSTEM76_EC_BAT_THRESHOLDS
	select EC_ACPI

config BOARD_CLEVO_L140MU_BASE
	bool
	select BOARD_CLEVO_TGLU_COMMON
	select HAVE_SPD_IN_CBFS

config BOARD_CLEVO_NV40MZ_BASE
	bool
	select BOARD_CLEVO_TGLU_COMMON
	select EC_SYSTEM76_EC_DGPU
	select DRIVER_NVIDIA_OPTIMUS

config BOARD_CLEVO_NS50MU_BASE
	bool
	select BOARD_CLEVO_TGLU_COMMON
	select DRIVERS_GENERIC_BAYHUB_LV2

config BOARD_CLEVO_L140MU
	select BOARD_CLEVO_L140MU_BASE

config BOARD_CLEVO_NV40MZ
	select BOARD_CLEVO_NV40MZ_BASE

config BOARD_CLEVO_NS50MU
	select BOARD_CLEVO_NS50MU_BASE

if BOARD_CLEVO_TGLU_COMMON

config MAINBOARD_DIR
	default "clevo/tgl-u"

config VARIANT_DIR
	default "l140mu" if BOARD_CLEVO_L140MU_BASE
	default "nv40mz" if BOARD_CLEVO_NV40MZ_BASE
	default "ns50mu" if BOARD_CLEVO_NS50MU_BASE

config MAINBOARD_PART_NUMBER
	default "L140MU" if BOARD_CLEVO_L140MU
	default "NV40MZ" if BOARD_CLEVO_NV40MZ
	default "NS50MU" if BOARD_CLEVO_NS50MU

config MAINBOARD_SMBIOS_PRODUCT_NAME
	default "NS50_70MU" if BOARD_CLEVO_NS50MU_BASE
	default "NV4XMB,ME,MZ" if BOARD_CLEVO_NV40MZ_BASE

config MAINBOARD_SMBIOS_MANUFACTURER
	default "Notebook"

config MAINBOARD_VERSION
	default "2.2A" if BOARD_CLEVO_L140MU_BASE
	default "2.2A" if BOARD_CLEVO_NV40MZ_BASE
	default "2.2A" if BOARD_CLEVO_NS50MU_BASE

config MAINBOARD_FAMILY
	string
	default "Not Applicable" # Match stock firmware

config DEVICETREE
	default "variants/\$(CONFIG_VARIANT_DIR)/devicetree.cb"

config CBFS_SIZE
	default 0xb00000 if BOARD_CLEVO_L140MU_BASE
	default 0xb00000 if BOARD_CLEVO_NV40MZ_BASE
	default 0xb00000 if BOARD_CLEVO_NS50MU_BASE

config CONSOLE_POST
	default y

config UART_FOR_CONSOLE
	default 2

config TPM_PIRQ
	default 0x77 if BOARD_CLEVO_L140MU_BASE # GPP_C9_IRQ
	default 0x1C if BOARD_CLEVO_NV40MZ_BASE # GPP_C14_IRQ
	default 0x1C if BOARD_CLEVO_NS50MU_BASE # GPP_C14_IRQ

config VBOOT
	select GBB_FLAG_DISABLE_EC_SOFTWARE_SYNC
	select GBB_FLAG_DISABLE_FWMP
	select GBB_FLAG_DISABLE_LID_SHUTDOWN
	select GBB_FLAG_DISABLE_PD_SOFTWARE_SYNC
	select HAS_RECOVERY_MRC_CACHE
	select VBOOT_ALWAYS_ENABLE_DISPLAY
	select VBOOT_CLEAR_RECOVERY_EACH_BOOT
	select VBOOT_MOCK_SECDATA
	select VBOOT_NO_BOARD_SUPPORT

config VBOOT_SLOTS_RW_A
	default y if VBOOT

config VBOOT_VBNV_OFFSET
	hex
	default 0x28

config FMDFILE
	string
	default "src/mainboard/\$(CONFIG_MAINBOARD_DIR)/vboot-rwa.fmd" if VBOOT && VBOOT_SLOTS_RW_A

config POST_DEVICE
	default n

config SEABIOS_PS2_TIMEOUT
	default 500

config USE_PM_ACPI_TIMER
	default n

config VBOOT_FWID_VERSION
	default "\$(CONFIG_LOCALVERSION)"

endif
```

## src/mainboard/clevo/tgl-u/Kconfig.name
```kconfig
## SPDX-License-Identifier: GPL-2.0-only

comment "Tiger Lake U"

config BOARD_CLEVO_L140MU
	bool "L140MU / L141MU / L142MU"

config BOARD_CLEVO_NV40MZ
	bool "NV4xMB / NV4xME / NV4xMZ"

config BOARD_CLEVO_NS50MU
	bool "NS5xMU / NS7xMU"
```

## src/mainboard/dell/latitude_6430u/Kconfig
```kconfig
if BOARD_DELL_LATITUDE_6430U

config BOARD_SPECIFIC_OPTIONS
	def_bool y
	select BOARD_ROMSIZE_KB_12288
	select EC_DELL_MEC5055
	select HAVE_ACPI_RESUME
	select HAVE_ACPI_TABLES
	select INTEL_INT15
	select MAINBOARD_HAS_LIBGFXINIT
	select NORTHBRIDGE_INTEL_SANDYBRIDGE
	select SERIRQ_CONTINUOUS_MODE
	select SOUTHBRIDGE_INTEL_C216
	select SYSTEM_TYPE_LAPTOP
	select USE_NATIVE_RAMINIT
	select PCIEXP_L1_SUB_STATE
	select MAINBOARD_HAS_LPC_TPM
	select MAINBOARD_HAS_TPM1
	select MAINBOARD_USES_IFD_GBE_REGION

config MAINBOARD_DIR
	string
	default "dell/latitude_6430u"

config MAINBOARD_PART_NUMBER
	string
	default "Latitude 6430U"

config VGA_BIOS_FILE
	string
	default "pci8086,0166.rom"

config VGA_BIOS_ID
	string
	default "8086,0166"

config DRAM_RESET_GATE_GPIO
	int
	default 60

config USBDEBUG_HCD_INDEX
	int
	default 2

config CBFS_SIZE
	hex
	default 0x600000

endif
```

## src/mainboard/hardkernel/odroid_h4/Kconfig
```kconfig
if BOARD_HARDKERNEL_ODROID_H4

config BOARD_SPECIFIC_OPTIONS
	def_bool y
	select BOARD_ROMSIZE_KB_16384
	select SOC_INTEL_ALDERLAKE_PCH_N
	select SOC_INTEL_COMMON_BLOCK_HDA_VERB
	select SUPERIO_ITE_IT8613E
	select CRB_TPM
	select DRIVERS_UART_8250IO
	select FSP_TYPE_IOT
	select HAVE_ACPI_RESUME
	select HAVE_ACPI_TABLES
	select HAVE_INTEL_PTT
	select INTEL_GMA_HAVE_VBT
	select USE_DDR5

config MAINBOARD_DIR
	default "hardkernel/odroid_h4"

config MAINBOARD_PART_NUMBER
	default "ODROID-H4"

config MAINBOARD_VENDOR
	default "HARDKERNEL"

config MAINBOARD_FAMILY
	default "Default String"

config DIMM_SPD_SIZE
	default 1024

config DIMM_MAX
	default 2

config UART_FOR_CONSOLE
	default 0

config USE_PM_ACPI_TIMER
	default n

config CBFS_SIZE
	default 0xa00000

config VBOOT
	select GBB_FLAG_DISABLE_EC_SOFTWARE_SYNC
	select GBB_FLAG_DISABLE_FWMP
	select GBB_FLAG_DISABLE_LID_SHUTDOWN
	select GBB_FLAG_DISABLE_PD_SOFTWARE_SYNC
	select VBOOT_ALWAYS_ENABLE_DISPLAY
	select VBOOT_NO_BOARD_SUPPORT
	select HAS_RECOVERY_MRC_CACHE
	select VBOOT_NO_TPM
	select VBOOT_ENABLE_CBFS_FALLBACK
	select VBOOT_CLEAR_RECOVERY_IN_RAMSTAGE

config VBOOT_SLOTS_RW_A
	default y if VBOOT

config SOC_INTEL_CSE_SEND_EOP_EARLY
	default n

config FMDFILE
	default "src/mainboard/\$(CONFIG_MAINBOARD_DIR)/vboot-rwa.fmd" if VBOOT && VBOOT_SLOTS_RW_A

endif
```

## src/mainboard/intel/minnowmax/Kconfig
```kconfig
## SPDX-License-Identifier: GPL-2.0-only

if BOARD_INTEL_MINNOWMAX

config BOARD_SPECIFIC_OPTIONS
	def_bool y
	select SOC_INTEL_BAYTRAIL
	select BOARD_ROMSIZE_KB_8192
	select ENABLE_BUILTIN_COM1
	select HAVE_SPD_IN_CBFS
	select HAVE_ACPI_TABLES
	select HAVE_ACPI_RESUME
	select HAVE_OPTION_TABLE
	select INTEL_GMA_HAVE_VBT
	select HAVE_CF9_RESET_PREPARE

config MAINBOARD_DIR
	string
	default "intel/minnowmax"

config MAINBOARD_PART_NUMBER
	string
	default "Minnow Max"

config MAX_CPUS
	int
	default 16

config DIMM_SPD_SIZE
	int
	default 256

config CBFS_SIZE
	hex
	default 0x00600000

config POST_DEVICE
	bool
	default n

config VGA_BIOS
	bool
	default y

config FMDFILE
	default "src/mainboard/\$(CONFIG_MAINBOARD_DIR)/board_sb.fmd" if TXE_SECURE_BOOT
	default "src/mainboard/\$(CONFIG_MAINBOARD_DIR)/board.fmd"

endif # BOARD_INTEL_MINNOWMAX
```

## src/mainboard/intel/minnowmax/Kconfig.name
```kconfig
## SPDX-License-Identifier: GPL-2.0-only

config BOARD_INTEL_MINNOWMAX
	bool "Minnow Max"
```

## src/mainboard/lenovo/m920q/Kconfig
```kconfig
if BOARD_LENOVO_M920Q

config BOARD_SPECIFIC_OPTIONS
	def_bool y
	select SOC_INTEL_CANNONLAKE_PCH_H
	select SOC_INTEL_COFFEELAKE
	select BOARD_ROMSIZE_KB_24576
	select HAVE_ACPI_RESUME
	select HAVE_ACPI_TABLES
	select HAVE_OPTION_TABLE
	select HAVE_CMOS_DEFAULT
	select MAINBOARD_HAS_TPM2
	select MEMORY_MAPPED_TPM
	select INTEL_GMA_HAVE_VBT
	select MAINBOARD_HAS_LIBGFXINIT
	select MAINBOARD_USES_IFD_GBE_REGION
	select SUPERIO_NUVOTON_NCT6687D
	select DRIVERS_UART_8250IO

config MAINBOARD_DIR
	default "lenovo/m920q"

config MAINBOARD_PART_NUMBER
	default "ThinkCentre M920 Tiny"

config PRERAM_CBMEM_CONSOLE_SIZE
	hex
	default 0xd00

config DIMM_SPD_SIZE
	default 512 #DDR4

config CBFS_SIZE
	default 0x900000

config DRIVER_LENOVO_SERIALS
	bool
	default n

endif
```

## src/mainboard/lenovo/thinkcentre_m700/Kconfig
```kconfig
if BOARD_LENOVO_THINKCENTRE_M700

config BOARD_SPECIFIC_OPTIONS
	def_bool y
	select BOARD_ROMSIZE_KB_8192
	select HAVE_ACPI_RESUME
	select HAVE_ACPI_TABLES
	select MAINBOARD_HAS_LIBGFXINIT
	select HAVE_OPTION_TABLE
	select HAVE_CMOS_DEFAULT
	select INTEL_GMA_HAVE_VBT
	select INTEL_INT15
	select SOC_INTEL_KABYLAKE
	select SKYLAKE_SOC_PCH_H
	select REALTEK_8168_RESET
	select RT8168_SET_LED_MODE
	select MAINBOARD_HAS_LPC_TPM
	select SUPERIO_ITE_IT8625E

config DISABLE_HECI1_AT_PRE_BOOT
	default y

config MAINBOARD_DIR
	default "lenovo/thinkcentre_m700"

config MAINBOARD_PART_NUMBER
	default "ThinkCentre M700"

config PRERAM_CBMEM_CONSOLE_SIZE
	hex
	default 0xd00

config DIMM_SPD_SIZE
	default 512 #DDR4

endif
```

## src/mainboard/msi/Kconfig
```kconfig
## SPDX-License-Identifier: GPL-2.0-only

if VENDOR_MSI

choice
	prompt "Mainboard model"

source "src/mainboard/msi/*/Kconfig.name"

endchoice

source "src/mainboard/msi/*/Kconfig"

config MAINBOARD_VENDOR
	default "MSI"

config BOARD_HAS_MSI_ROMHOLE
	bool
	default n

config MSI_ROMHOLE_IN_CBFS
	bool "Put the MSI ROMHOLE as CBFS file"
	depends on BOARD_HAS_MSI_ROMHOLE && !VBOOT
	default n

config MSI_ROMHOLE_ADDRESS_IN_CBFS
	hex "MSI ROMHOLE address in CBFS"
	depends on MSI_ROMHOLE_IN_CBFS
	default 0xff7c0000 if BOARD_ROMSIZE_KB_32768

config MSI_ROMHOLE_SIZE_IN_CBFS
	hex "MSI ROMHOLE size in CBFS"
	depends on MSI_ROMHOLE_IN_CBFS
	default 0x20000

endif # VENDOR_MSI
```

## src/mainboard/msi/ms7d25/Kconfig
```kconfig
config BOARD_MSI_Z690_A_PRO_WIFI_DDR4
	select BOARD_MSI_MS7D25

config BOARD_MSI_Z690_A_PRO_WIFI_DDR5
	select BOARD_MSI_MS7D25

config BOARD_MSI_MS7D25
	def_bool n
	select SOC_INTEL_ALDERLAKE_PCH_S
	select SOC_INTEL_RAPTORLAKE
	select BOARD_ROMSIZE_KB_32768
	select SOC_INTEL_COMMON_BLOCK_HDA_VERB
	select SUPERIO_NUVOTON_NCT6687D
	select DRIVERS_UART_8250IO
	select HAVE_ACPI_RESUME
	select HAVE_ACPI_TABLES
	select INTEL_GMA_HAVE_VBT
	select MEMORY_MAPPED_TPM
	select CRB_TPM
	select HAVE_INTEL_PTT
	select BOARD_HAS_MSI_ROMHOLE

if BOARD_MSI_MS7D25

config MAINBOARD_DIR
	default "msi/ms7d25"

config MAINBOARD_PART_NUMBER
	default "PRO Z690-A WIFI DDR4(MS-7D25)" if BOARD_MSI_Z690_A_PRO_WIFI_DDR4
	default "PRO Z690-A WIFI (MS-7D25)" if BOARD_MSI_Z690_A_PRO_WIFI_DDR5

config MAINBOARD_VENDOR
	default "Micro-Star International Co., Ltd."

config MAINBOARD_FAMILY
	default "Default string"

config MAINBOARD_VERSION
	default "2.0" if BOARD_MSI_Z690_A_PRO_WIFI_DDR5

config DIMM_SPD_SIZE
	default 512

config UART_FOR_CONSOLE
	default 0

config USE_PM_ACPI_TIMER
	default n

config USE_LEGACY_8254_TIMER
	default y

config CBFS_SIZE
	default 0x1000000

config TPM_PIRQ
	default 0x3f # GPP_E7_IRQ

config VBOOT
	select GBB_FLAG_DISABLE_EC_SOFTWARE_SYNC
	select GBB_FLAG_DISABLE_FWMP
	select GBB_FLAG_DISABLE_LID_SHUTDOWN
	select GBB_FLAG_DISABLE_PD_SOFTWARE_SYNC
	select VBOOT_ALWAYS_ENABLE_DISPLAY
	select VBOOT_NO_BOARD_SUPPORT
	select HAS_RECOVERY_MRC_CACHE
	select VBOOT_NO_TPM
	select VBOOT_CLEAR_RECOVERY_EACH_BOOT

config VBOOT_SLOTS_RW_AB
	default y if VBOOT

config SOC_INTEL_CSE_SEND_EOP_EARLY
	default n

config FMDFILE
	default "src/mainboard/\$(CONFIG_MAINBOARD_DIR)/vboot-rwab.fmd" if VBOOT && VBOOT_SLOTS_RW_AB

# gen_test_hwid.sh script doesn't like parentheses in the MAINBOARD_PART_NUMBER
# Override the GBB_HWID
config GBB_HWID
	default "MSI_MS7D25"

if !VBOOT && MSI_ROMHOLE_IN_CBFS

# FIXME: Make coreboot build system automatically fixup the ucode and FIT location
# so that creating FIT does not fail.
config CPU_MICROCODE_CBFS_LOC
	hex
	default 0xff800000

config INTEL_FIT_LOC
	hex
	default 0xfffc0000

endif

endif
```

## src/mainboard/novacustom/adl-p/Kconfig
```kconfig
config BOARD_NOVACUSTOM_NS5X_ADLP
	select BOARD_CLEVO_NS50PU_BASE

config BOARD_NOVACUSTOM_NV4X_ADLP
	select BOARD_CLEVO_NV40PZ_BASE

config MAINBOARD_PART_NUMBER
	default "nv40pz" if BOARD_NOVACUSTOM_NV4X_ADLP
	default "ns50pu" if BOARD_NOVACUSTOM_NS5X_ADLP
```

## src/mainboard/novacustom/adl-p/Kconfig.name
```kconfig
comment "Alder Lake P (2022)"

config BOARD_NOVACUSTOM_NS5X_ADLP
	bool "NS5x ADL"

config BOARD_NOVACUSTOM_NV4X_ADLP
	bool "NV4x ADL"
```

## src/mainboard/novacustom/ns5x/Kconfig.name
```kconfig
config BOARD_NOVACUSTOM_NS5X
	bool "NS50MU / NS51MU"
	select BOARD_CLEVO_NS50MU_BASE
```

## src/mainboard/novacustom/nv4x/Kconfig
```kconfig
if BOARD_NOVACUSTOM_NV4X

config MAINBOARD_PART_NUMBER
	default "nv41mz"

endif # BOARD_NOVACUSTOM_NV4X
```

## src/mainboard/novacustom/tgl-u/Kconfig
```kconfig
config BOARD_NOVACUSTOM_NV4X_TGLU
	select BOARD_CLEVO_NV40MZ_BASE

config BOARD_NOVACUSTOM_NS5X_TGLU
	select BOARD_CLEVO_NS50MU_BASE

config MAINBOARD_PART_NUMBER
	default "nv40mz" if BOARD_NOVACUSTOM_NV4X_TGLU
	default "ns50mu" if BOARD_NOVACUSTOM_NS5X_TGLU
```

## src/mainboard/novacustom/tgl-u/Kconfig.name
```kconfig
comment "Tiger Lake U (2021)"

config BOARD_NOVACUSTOM_NV4X_TGLU
	bool "NV4x TGL"

config BOARD_NOVACUSTOM_NS5X_TGLU
	bool "NS5x TGL"
```

## src/mainboard/pcengines/Kconfig
```kconfig
if VENDOR_PCENGINES

choice
	prompt "Mainboard model"
	default	BOARD_PCENGINES_APU2

config BOARD_PCENGINES_APU2
	bool "APU2"

config BOARD_PCENGINES_APU3
	bool "APU3"

config BOARD_PCENGINES_APU4
	bool "APU4"

config BOARD_PCENGINES_APU5
	bool "APU5"

endchoice

source "src/mainboard/pcengines/apu2/Kconfig"

config MAINBOARD_VENDOR
	string
	default "PC Engines"

endif # VENDOR_PCENGINES
```
