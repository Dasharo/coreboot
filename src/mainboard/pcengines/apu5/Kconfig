## src/mainboard/pcengines/apu5/Kconfig
```kconfig
#
# This file is part of the coreboot project.
#
# Copyright (C) 2012 Advanced Micro Devices, Inc.
# Copyright (C) 2016 Eltan B.V.
#
# This program is free software; you can redistribute it and/or modify
# it under the terms of the GNU General Public License as published by
# the Free Software Foundation; version 2 of the License.
#
# This program is distributed in the hope that it will be useful,
# but WITHOUT ANY WARRANTY; without even the implied warranty of
# MERCHANTABILITY or FITNESS FOR A PARTICULAR PURPOSE.  See the
# GNU General Public License for more details.
#
# You should have received a copy of the GNU General Public License
# along with this program; if not, write to the Free Software
# Foundation, Inc., 51 Franklin St, Fifth Floor, Boston, MA 02110-1301 USA
#

if BOARD_PCENGINES_APU5

config BOARD_SPECIFIC_OPTIONS # dummy
	def_bool y
	select CPU_AMD_PI_00730F01
	select NORTHBRIDGE_AMD_PI_00730F01
	select SOUTHBRIDGE_AMD_PI_AVALON
	select SUPERIO_NUVOTON_NCT5104D
	select HAVE_PIRQ_TABLE
	select HAVE_MP_TABLE
#	select HAVE_ACPI_RESUME
	select HAVE_ACPI_TABLES
	select BOARD_ROMSIZE_KB_8192
#	select GFXUMA						# disable graphics
	select SPD_CACHE
	select HUDSON_DISABLE_IMC
#	select HAVE_OPTION_TABLE			# Removed the CMOS support as the boot
#	select USE_OPTION_TABLE				# order can be fixed now.
#	select HAVE_CMOS_DEFAULT
	select USE_CBMEM_FILE_OVERRIDE

config MAINBOARD_DIR
	string
	default pcengines/apu5

config MAINBOARD_PART_NUMBER
	string
	default "PC Engines apu5"

config SVI2_SLOW_SPEED
	bool	"SVI2 slow speed"
	default n
	help
		Used when there are problems switching the VRM speed. By default
		speed is 20 Mhz

config SVI_WAIT_COMP_DIS
	bool	"Disable SVI2 controller waits for command completion"
	default y
	help
		SVI2 controller will not wait for command completion from VRM

config HW_MEM_HOLE_SIZEK
	hex
	default 0x200000

config MAX_CPUS
	int
	default 4

config HW_MEM_HOLE_SIZE_AUTO_INC
	bool
	default n

config IRQ_SLOT_COUNT
	int
	default 11

config RAMTOP
	hex
	default 0x1000000

config HEAP_SIZE
	hex
	default 0xc0000

config ACPI_SSDTX_NUM
	int
	default 0

config RAMBASE
	hex
	default 0x200000

#config ONBOARD_VGA_IS_PRIMARY
#	bool
#	default y

config HUDSON_LEGACY_FREE
	bool
	default y

config HUDSON_XHCI_ENABLE
	bool
	default y

config DRIVERS_PS2_KEYBOARD
	bool
	default n

config AGESA_HEAP_MEMTEST
	bool
	default y

config VGA_ROM_RUN
	bool
	default n

config DUMP_GPIO_CONFIGURATION
	bool "Dump FCH GPIO configuration in board finalize"
	default n

config DUMP_CLOCK_CONFIGURATION
	bool "Dump FCH MISC configuration in board finalize"
	default n

config DUMP_LINK_CONFIGURATION
	bool "Dump PCIe LINK configuration in board finalize"
	default n

config FORCE_CONSOLE
	bool "always enable serial console"
	default n
	help
		by default serial console is only enabled when pressing S1

endif # BOARD_PCENGINES_APU5
```

## src/mainboard/protectli/vault_adl_n/Kconfig.name
```kconfig
config BOARD_PROTECTLI_VP32XX
	bool "VP3210/VP3230"

config BOARD_PROTECTLI_VP2430
	bool "VP2430"
```

## src/mainboard/protectli/vault_bsw/Kconfig.name
```kconfig
config BOARD_PROTECTLI_FW2B
	bool "FW2B"

config BOARD_PROTECTLI_FW4B
	bool "FW4B"

config BOARD_PROTECTLI_FW4C
	bool "FW4C"
```

## src/mainboard/protectli/vault_cml/Kconfig
```kconfig
if BOARD_PROTECTLI_VP4620

config BOARD_SPECIFIC_OPTIONS
	def_bool y
	select BOARD_ROMSIZE_KB_16384
	select SOC_INTEL_COMETLAKE_2
	select HAVE_ACPI_RESUME
	select HAVE_ACPI_TABLES
	select HAVE_CMOS_DEFAULT
	select HAVE_OPTION_TABLE
	select SOC_INTEL_COMMON_BLOCK_HDA_VERB
	select SOC_INTEL_COMMON_BLOCK_HDA
	select SUPERIO_ITE_IT8786E
	select INTEL_GMA_HAVE_VBT
	select SEABIOS_ADD_SERCON_PORT_FILE if PAYLOAD_SEABIOS
	select SPI_FLASH_MACRONIX
	select TPM_MEASURED_BOOT
	select MAINBOARD_HAS_CRB_TPM
	select HAVE_INTEL_PTT
	select MAINBOARD_HAS_TPM2

config MAINBOARD_DIR
	string
	default "protectli/vault_cml"

config MAINBOARD_PART_NUMBER
	string
	default "VP4620"

config MAINBOARD_FAMILY
	string
	default "Vault Pro"

config DIMM_MAX
	int
	default 2

config MAX_CPUS
	int
	default 8

config DEVICETREE
	string
	default "devicetree.cb"

config DIMM_SPD_SIZE
	int
	default 512

config VGA_BIOS_ID
	string
	default "8086,9b41"

config VBOOT
	select GBB_FLAG_DISABLE_EC_SOFTWARE_SYNC
	select GBB_FLAG_DISABLE_FWMP
	select GBB_FLAG_DISABLE_LID_SHUTDOWN
	select GBB_FLAG_DISABLE_PD_SOFTWARE_SYNC
	select VBOOT_ALWAYS_ENABLE_DISPLAY
	select VBOOT_NO_BOARD_SUPPORT

config VBOOT_SLOTS_RW_A
	default y if VBOOT

config FMDFILE
	string
	default "src/mainboard/\$(CONFIG_MAINBOARD_DIR)/vboot-rwa.fmd" if VBOOT && VBOOT_SLOTS_RW_A

endif
```

## src/mainboard/protectli/vault_ehl/Kconfig
```kconfig
## SPDX-License-Identifier: GPL-2.0-only

if BOARD_PROTECTLI_VP2420

config BOARD_SPECIFIC_OPTIONS
	def_bool y
	select SOC_INTEL_ELKHARTLAKE
	select BOARD_ROMSIZE_KB_16384
	select HAVE_ACPI_RESUME
	select HAVE_ACPI_TABLES
	select SUPERIO_ITE_IT8613E
	select SPI_FLASH_MACRONIX
	select INTEL_GMA_HAVE_VBT
	select SEABIOS_ADD_SERCON_PORT_FILE if PAYLOAD_SEABIOS

config MAINBOARD_DIR
	default "protectli/vault_ehl"

config MAINBOARD_PART_NUMBER
	default "VP2420"

config MAINBOARD_FAMILY
	default "Vault Pro"

config MAX_CPUS
	default 4

config CBFS_SIZE
	default 0x900000

endif # BOARD_PROTECTLI_VP2420
```

## src/mainboard/protectli/vault_glk/Kconfig
```kconfig
## SPDX-License-Identifier: GPL-2.0-only

if BOARD_PROTECTLI_VP2410

config BOARD_SPECIFIC_OPTIONS
	def_bool y
	select SOC_INTEL_GEMINILAKE
	select BOARD_ROMSIZE_KB_8192
	select HAVE_ACPI_RESUME
	select HAVE_ACPI_TABLES
	select MEMORY_MAPPED_TPM
	select SUPERIO_ITE_IT8613E
	select SPI_FLASH_MACRONIX
	select INTEL_GMA_HAVE_VBT
	select SOC_INTEL_COMMON_BLOCK_HDA_VERB
	select SEABIOS_ADD_SERCON_PORT_FILE if PAYLOAD_SEABIOS
	select NEED_IFWI

config MAINBOARD_DIR
	string
	default "protectli/vault_glk"

config DEVICETREE
	string
	default "devicetree.cb"

config MAINBOARD_PART_NUMBER
	string
	default "VP2410"

config MAINBOARD_FAMILY
	default "Vault Pro"

config DIMM_MAX
	default 1

config DIMM_SPD_SIZE
	default 512

config MAX_CPUS
	default 4

config SOC_INTEL_COMMON_BLOCK_SGX_ENABLE
	default y

config USE_LEGACY_8254_TIMER
	default y

config FMDFILE
	string
	default "src/mainboard/\$(CONFIG_MAINBOARD_DIR)/board.fmd" if !VBOOT

endif # BOARD_PROTECTLI_VP2410
```

## src/mainboard/protectli/vault_glk/Kconfig.name
```kconfig
## SPDX-License-Identifier: GPL-2.0-only

config BOARD_PROTECTLI_VP2410
	bool "VP2410"
```

## src/mainboard/protectli/vault_jsl/Kconfig
```kconfig
if BOARD_PROTECTLI_V1210 || BOARD_PROTECTLI_V1211 || BOARD_PROTECTLI_V1410 || BOARD_PROTECTLI_V1610

config BOARD_SPECIFIC_OPTIONS
	def_bool y
	select BOARD_ROMSIZE_KB_16384
	select SOC_INTEL_JASPERLAKE
	select SOC_INTEL_COMMON_BLOCK_HDA_VERB
	select SUPERIO_ITE_IT8613E
	select INTEL_GMA_HAVE_VBT
	select HAVE_ACPI_RESUME
	select HAVE_ACPI_TABLES
	select HAVE_SPD_IN_CBFS
	select USE_LPDDR4
	select CRB_TPM
	select HAVE_INTEL_PTT
	select MAINBOARD_HAS_TPM2

config MAX_CPUS
	default 4

config MAINBOARD_DIR
	string
	default "protectli/vault_jsl"

config MAINBOARD_PART_NUMBER
	string
	default "V1210" if BOARD_PROTECTLI_V1210
	default "V1211" if BOARD_PROTECTLI_V1211
	default "V1410" if BOARD_PROTECTLI_V1410
	default "V1610" if BOARD_PROTECTLI_V1610

config MAINBOARD_FAMILY
	string
	default "Vault"

config DIMM_MAX
	default 2

config DIMM_SPD_SIZE
	default 512

config CBFS_SIZE
	default 0x800000

config FMDFILE
	default "src/mainboard/\$(CONFIG_MAINBOARD_DIR)/board.fmd"

config BEEP_ON_BOOT
	bool "Beep on successful boot"
	default y
	help
	  Make the platform beep using the PC speaker in final coreboot phase.
	  May serve as a useful indicator in headless mode that platform is
	  properly booting.

endif
```

## src/mainboard/protectli/vault_jsl/Kconfig.name
```kconfig
config BOARD_PROTECTLI_V1210
	bool "V1210"

config BOARD_PROTECTLI_V1211
	bool "V1211"

config BOARD_PROTECTLI_V1410
	bool "V1410"

config BOARD_PROTECTLI_V1610
	bool "V1610"
```

## src/mainboard/protectli/vault_kbl/Kconfig
```kconfig
if BOARD_PROTECTLI_FW6

config BOARD_SPECIFIC_OPTIONS
	def_bool y
	select BOARD_ROMSIZE_KB_8192
	select HAVE_ACPI_RESUME
	select HAVE_ACPI_TABLES
	select INTEL_GMA_HAVE_VBT
	select MAINBOARD_HAS_LIBGFXINIT
	select SEABIOS_ADD_SERCON_PORT_FILE if PAYLOAD_SEABIOS
	select SOC_INTEL_KABYLAKE
	select SOC_INTEL_COMMON_BLOCK_HDA_VERB
	select SPI_FLASH_MACRONIX
	select SUPERIO_ITE_IT8613E
	select CRB_TPM
	select HAVE_INTEL_PTT
	select MAINBOARD_HAS_TPM2

config MAINBOARD_DIR
	default "protectli/vault_kbl"

config MAINBOARD_PART_NUMBER
	default	"FW6"

config MAINBOARD_FAMILY
	default "Vault"

config DIMM_MAX
	default 2

config DIMM_SPD_SIZE
	default 512

config MAX_CPUS
	default 8

config DEVICETREE
	default "devicetree.cb"

config VGA_BIOS_ID
	default "8086,5916" # FW6A/B/C

config VGA_BIOS_SECOND_ID
	default "8086,5917" # FW6D/E

config PXE_ROM_ID
	default "8086,150c"

config CBFS_SIZE
	default 0x600000

config FMDFILE
	default "src/mainboard/\$(CONFIG_MAINBOARD_DIR)/board.fmd"

config BEEP_ON_BOOT
	bool "Beep on successful boot"
	default y
	help
	  Make the platform beep using the PC speaker in final coreboot phase.
	  May serve as a useful indicator in headless mode that platform is
	  properly booting.


endif
```

## src/mainboard/raptor-cs/talos-2/Kconfig
```kconfig
## SPDX-License-Identifier: GPL-2.0-only

if BOARD_RAPTOR_CS_TALOS_2

config BOARD_SPECIFIC_OPTIONS
	def_bool y
	select CPU_POWER9
	select CPU_IBM_POWER9
	select BOARD_ROMSIZE_KB_512
	select ARCH_BOOTBLOCK_PPC64
	select ARCH_VERSTAGE_PPC64
	select ARCH_ROMSTAGE_PPC64
	select ARCH_RAMSTAGE_PPC64
	select SUPERIO_ASPEED_AST2400
	select BOOT_DEVICE_NOT_SPI_FLASH
	select MISSING_BOARD_RESET
	select HAVE_DEBUG_RAM_SETUP

config MEMLAYOUT_LD_FILE
	string
	default "src/mainboard/\$(CONFIG_MAINBOARD_DIR)/memlayout.ld"

config MAINBOARD_DIR
	string
	default "raptor-cs/talos-2"

config MAINBOARD_PART_NUMBER
	string
	default "Talos II"

# I'm not sure how to deal with 2 CPUs with regard to DIMM count, but that's
# a problem for later.
config DIMM_MAX
	int
	default 8

config DIMM_SPD_SIZE
	int
	default 512

config MAX_CPUS
	int
	default 1

config MAINBOARD_VENDOR
	string
	default "Raptor CS"

config DRAM_SIZE_MB
	int
	default 32768

endif #  BOARD_RAPTOR_CS_TALOS_2
```

## src/mainboard/tuxedo/Kconfig
```kconfig
if VENDOR_TUXEDO

choice
	prompt "Mainboard model"

source "src/mainboard/tuxedo/*/Kconfig.name"
endchoice

source "src/mainboard/tuxedo/*/Kconfig"
source "src/mainboard/clevo/*/Kconfig"

config MAINBOARD_VENDOR
	default "TUXEDO"

endif # VENDOR_TUXEDO
```

## src/mainboard/tuxedo/ibs15/Kconfig
```kconfig
if BOARD_INFINITYBOOK_S_15_GEN6

config MAINBOARD_PART_NUMBER
	default "InfinityBook S 15 Gen 6"

endif # BOARD_INFINITYBOOK_S_15_GEN6
```

## src/mainboard/tuxedo/ibs15/Kconfig.name
```kconfig
comment "Generation 6"

config BOARD_INFINITYBOOK_S_15_GEN6
	bool "InfinityBook S 15 Gen6"
	select BOARD_CLEVO_NS50MU_BASE
```

## src/northbridge/amd/Kconfig
```kconfig
#source src/northbridge/amd/amdk8/Kconfig
#source src/northbridge/amd/gx2/Kconfig
#source src/northbridge/amd/amdfam10/Kconfig

config SB_HT_CHAIN_UNITID_OFFSET_ONLY
	bool
#	default n

config 	HT_CHAIN_UNITID_BASE
	hex 
#	default n
	
config 	HT_CHAIN_END_UNITID_BASE
	hex
#	default n
	
#source src/northbridge/amd/lx/Kconfig
#source src/northbridge/amd/agesa/Kconfig
#source src/northbridge/amd/cimx/Kconfig
source src/northbridge/amd/pi/Kconfig
```

## src/northbridge/amd/amdfam10/Kconfig
```kconfig
## SPDX-License-Identifier: GPL-2.0-only

config NORTHBRIDGE_AMD_AMDFAM10
	bool
	select HAVE_DEBUG_RAM_SETUP
	select HAVE_DEBUG_SMBUS
	select HAVE_DEBUG_CAR
	select PCIEXP_ASPM
	select PCIEXP_COMMON_CLOCK
	select PCIEXP_CLK_PM
	select PCIEXP_L1_SUB_STATE
	select HYPERTRANSPORT_PLUGIN_SUPPORT
	select DRIVERS_AMD_HYPERTRANSPORT
	select DRIVERS_AMD_MCT

if NORTHBRIDGE_AMD_AMDFAM10
config AGP_APERTURE_SIZE
	hex
	default 0x4000000

config HW_MEM_HOLE_SIZEK
	hex
	default 0x100000

config MMCONF_BASE_ADDRESS
	hex
	default 0xc0000000

config MMCONF_BUS_NUMBER
	int
	default 256

config HEAP_SIZE
	hex
	default 0xc0000

config SB_HT_CHAIN_UNITID_OFFSET_ONLY
	bool
	default n

config HT_CHAIN_DISTRIBUTE
	def_bool n

config DIMM_DDR2
	bool
	default n

config DIMM_DDR3
	bool
	default n

config DIMM_REGISTERED
	bool
	default n

config DIMM_VOLTAGE_SET_SUPPORT
	bool
	default n

config S3_DATA_SIZE
	int
	default 32768
	depends on (HAVE_ACPI_RESUME)

config S3_DATA_POS
	hex
	default 0x0
	depends on (HAVE_ACPI_RESUME)

config SVI_HIGH_FREQ
	bool
	default n
	help
	  Select this for boards with a Voltage Regulator able to operate
	  at 3.4 MHz in SVI mode. Ignored unless the AMD CPU is rev C3.

config SYSTEM_TYPE_SERVER
	bool
	default y

config SYSTEM_TYPE_DESKTOP
	bool

config SYSTEM_TYPE_MOBILE
	bool

config SMM_TSEG_SIZE
	hex
	default 0x800000

config SMM_RESERVED_SIZE
	hex
	default 0x150000

menu "HyperTransport setup"
	#could be implemented for K8 (NORTHBRIDGE_AMD_AMDK8)
	depends on (NORTHBRIDGE_AMD_AMDFAM10)

choice
	prompt "HyperTransport downlink width"
	default LIMIT_HT_DOWN_WIDTH_16
	help
	  This option sets the maximum permissible HyperTransport
	  downlink width.

	  Use of this option will only limit the autodetected HT width.
	  It will not (and cannot) increase the width beyond the autodetected
	  limits.

	  This is primarily used to work around poorly designed or laid out HT
	  traces on certain motherboards.

config LIMIT_HT_DOWN_WIDTH_8
	bool "8 bits"
config LIMIT_HT_DOWN_WIDTH_16
	bool "16 bits"
endchoice

choice
	prompt "HyperTransport uplink width"
	default LIMIT_HT_UP_WIDTH_16
	help
	  This option sets the maximum permissible HyperTransport
	  uplink width.

	  Use of this option will only limit the autodetected HT width.
	  It will not (and cannot) increase the width beyond the autodetected
	  limits.

	  This is primarily used to work around poorly designed or laid out HT
	  traces on certain motherboards.

config LIMIT_HT_UP_WIDTH_8
	bool "8 bits"
config LIMIT_HT_UP_WIDTH_16
	bool "16 bits"
endchoice

endmenu

config MAX_REBOOT_CNT
	int
	default 6

endif # NORTHBRIDGE_AMD_AMDFAM10
```
