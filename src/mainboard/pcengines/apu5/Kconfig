## src/soc/intel/baytrail/Kconfig
```kconfig
## SPDX-License-Identifier: GPL-2.0-only

config SOC_INTEL_BAYTRAIL
	bool
	select ACPI_COMMON_MADT_IOAPIC
	select ACPI_COMMON_MADT_LAPIC
	select ACPI_INTEL_HARDWARE_SLEEP_VALUES
	select ARCH_X86
	select BOOT_DEVICE_SUPPORTS_WRITES
	select CACHE_MRC_SETTINGS
	select CPU_INTEL_TURBO_NOT_PACKAGE_SCOPED
	select SUPPORT_CPU_UCODE_IN_CBFS
	select HAVE_SMI_HANDLER
	select SOUTHBRIDGE_INTEL_COMMON_RESET
	select SOUTHBRIDGE_INTEL_COMMON_SMBUS
	select SOUTHBRIDGE_INTEL_COMMON_SPI_SILVERMONT
	select PCIEXP_COMMON_CLOCK
	select REG_SCRIPT
	select RTC
	select SPI_FLASH
	select SSE2
	select TSC_MONOTONIC_TIMER
	select TSC_SYNC_MFENCE
	select UDELAY_TSC
	select SOC_INTEL_COMMON
	select INTEL_DESCRIPTOR_MODE_CAPABLE
	select HAVE_EM100PRO_SPI_CONSOLE_SUPPORT
	select INTEL_GMA_ACPI
	select INTEL_GMA_SWSMISCI
	select CPU_INTEL_COMMON
	select CPU_HAS_L2_ENABLE_MSR
	select TCO_SPACE_NOT_YET_SPLIT
	select USE_DDR3
	select UDK_2017_BINDING
	select HAVE_CF9_RESET_PREPARE
	help
	  Bay Trail M/D part support.

if SOC_INTEL_BAYTRAIL

config VBOOT
	select VBOOT_MUST_REQUEST_DISPLAY
	select VBOOT_STARTS_IN_ROMSTAGE

config ECAM_MMCONF_BASE_ADDRESS
	default 0xe0000000

config ECAM_MMCONF_BUS_NUMBER
	int
	default 256

config MAX_CPUS
	int
	default 4

config SMM_TSEG_SIZE
	hex
	default 0x800000

config SMM_RESERVED_SIZE
	hex
	default 0x100000

config DISABLE_HPET
	bool "Disable the HPET device"
	default n
	help
	 Enable this to disable the HPET support.
	 On BayTrail and Braswell/Cherry Trail platforms HPET halts
	 when CPU enters deep C states. Select this opton to prevent
	 the OS from using HPET as timer source, as it may lead to
	 soft CPU lockups.

config HAVE_MRC
	bool "Add a System Agent binary"
	help
	  Select this option to add a System Agent binary to
	  the resulting coreboot image.

	  Note: Without this binary coreboot will not work

config MRC_FILE
	string "Intel System Agent path and filename"
	depends on HAVE_MRC
	default "mrc.bin"
	help
	  The path and filename of the file to use as System Agent
	  binary.

config MRC_BIN_ADDRESS
	hex
	default 0xfffa0000

config MRC_RMT
	bool "Enable MRC RMT training"
	default n

config MRC_DEBUG_PRINTS
	bool "Enable MRC debug prints"
	default n

# Cache As RAM region layout:
#
# +-------------+ DCACHE_RAM_BASE + DCACHE_RAM_SIZE + DCACHE_RAM_MRC_VAR_SIZE
# | MRC usage   |
# |             |
# -------------+ DCACHE_RAM_BASE + DCACHE_RAM_SIZE
# | coreboot    |
# | usage       |
# +-------------+ DCACHE_RAM_BASE
#
# Note that the MRC binary is linked to assume the region marked as "MRC usage"
# starts at DCACHE_RAM_BASE + DCACHE_RAM_SIZE. If those values change then
# a new MRC binary needs to be produced with the updated start and size
# information.

config DCACHE_RAM_BASE
	hex
	default 0xfe000000

config DCACHE_RAM_SIZE
	hex
	default 0x8000
	help
	  The size of the cache-as-ram region required during bootblock
	  and/or romstage. Note DCACHE_RAM_SIZE and DCACHE_RAM_MRC_VAR_SIZE
	  must add up to a power of 2.

config PRERAM_CBFS_CACHE_SIZE
	default 0x0

config DCACHE_RAM_MRC_VAR_SIZE
	hex
	default 0x8000
	help
	  The amount of cache-as-ram region required by the reference code.

config DCACHE_BSP_STACK_SIZE
	hex
	default 0x2000

config ENABLE_BUILTIN_COM1
	bool "Enable builtin COM1 Serial Port"
	default n
	help
	  The PMC has a legacy COM1 serial port. Choose this option to
	  configure the pads and enable it. This serial port can be used for
	  the debug console.

config HAVE_REFCODE_BLOB
	depends on ARCH_X86
	bool "Use a binary refcode blob instead of native ModPHY init"
	default n
	help
	 Use the ChromeBook refcode to initialize high-speed PHYs instead of
	 native code.

if HAVE_REFCODE_BLOB

# Ask for the blob if the user wants it
config REFCODE_BLOB_FILE
	string "Path and filename to reference code blob."
	default "refcode.elf"
	help
	 The path and filename to the file to be added to cbfs.

endif # HAVE_REFCODE_BLOB

config VGA_BIOS_ID
	string
	depends on VGA_BIOS
	default "8086,0f31"

config BAYTRAIL_FTPM
	bool "Enable fTPM functionality in TXE"
	default n

config TXE_SECURE_BOOT
	bool "Perform verified boot with TXE Secure Boot"
	depends on !VBOOT
	select FIXED_BOOTBLOCK_SIZE
	default n
	help
	  The TXE on Baytrail SOC has Secure Boot capability. Choose this
	  option to enable the TXE Secure Boot verified boot flow in coreboot.

config TXE_SB_INCLUDE_KEY_MANIFEST
	bool "Include TXE Secure Boot Key Manifest"
	depends on TXE_SECURE_BOOT
	default n
	help
	  The TXE on Baytrail SOC has Secure Boot capability. Choose this
	  option to include the TXE Secure Boot Key Manifest, which can be
	  used to authorize the Secure Boot firmware signing key. This key
	  should be fused into TXE FPF instead of Secure Boot firmware signing
	  key. TXE Key Manifest ID FPF must not be zero in such case.

	  Key Manifest is optional.

config TXE_SB_GENERATE_KEY_MANIFEST
	bool "Generate TXE Secure Boot Key Manifest"
	depends on TXE_SB_INCLUDE_KEY_MANIFEST
	default n
	help
	  The TXE on Baytrail SOC has Secure Boot capability. Choose this
	  option to generate the TXE Secure Boot Key Manifest, which can be
	  used to authorize the Secure Boot firmware signing key. This key
	  should be fused into TXE FPF instead of Secure Boot firmware signing
	  key. TXE Key Manifest ID FPF must not be zero in such case.

	  Key Manifest is optional.

config TXE_SB_KEY_MANIFEST_PATH
	string "TXE Secure Boot Key Manifest file path"
	depends on TXE_SB_INCLUDE_KEY_MANIFEST && !TXE_SB_GENERATE_KEY_MANIFEST
	default ""
	help
	  THe path to a pre-generated TXE Secure Boot Key Manifest to be included
	  in the coreboot image.

	  Key Manifest is optional.

config TXE_SB_KEY_MANIFEST_KEY_PATH
	string "Include TXE Secure Boot Key Manifest Signing Key path"
	depends on TXE_SB_GENERATE_KEY_MANIFEST
	default ""
	help
	  Path to the signing key used to generate TXE Secure Boot Key Manifest.
	  RSA2048 private key in PEM or DER format required.

	  Key Manifest is optional.

config TXE_SB_KEY_MANIFEST_ID
	int "TXE Secure Boot Key Manifest ID value"
	depends on TXE_SB_GENERATE_KEY_MANIFEST
	range 1 15
	default 1
	help
	  Key Manifest ID used to generate TXE Secure Boot Key Manifest.

	  Key Manifest is optional.

config TXE_SB_KEY_MANIFEST_SVN
	int "TXE Secure Boot Key Manifest SVN value"
	depends on TXE_SB_GENERATE_KEY_MANIFEST
	range 0 15
	default 2
	help
	  Secure Version Number used to generate TXE Secure Boot Key Manifest.

	  Key Manifest is optional.

config TXE_SB_SBM_MANIFEST_KEY_PATH
	string "Include TXE Secure Boot Manifest Signing Key path"
	depends on TXE_SECURE_BOOT
	default ""
	help
	  Path to the signing key used to generate TXE Secure Boot Manifest.
	  RSA2048 private key in PEM or DER format required.

config TXE_SB_SBM_MANIFEST_SVN
	int "TXE Secure Boot Manifest SVN value"
	depends on TXE_SECURE_BOOT
	range 0 63
	default 2
	help
	  Secure Version Number used to generate TXE Secure Boot Manifest.

	  Key Manifest is optional.

if TXE_SECURE_BOOT

# This addresses will be used by BSP to locate microcode in bootblock before
# setting up CAR. With CBFS verification we cannot use walkcbfs ASM routine, so
# put the microcode copy in the BOOTBLOCK FMAP region right after SB manifest
# for use by BSP. APs will load microcode from CBFS file in COREBOOT region when
# CBFS_VERIFICATION will be able to verify it already in ramstage. It is safe to
# hardcode the address, because TXE will verify it together with IBB.

config EARLY_CPU_MICROCODE_LOC
	hex
	default 0xfffe0400

config EARLY_CPU_MICROCODE_LEN
	hex
	default 0x19800

# Ensure the bootblock does not overlap the microcode. We have 0x6400 bytes
# of space after microcode till the ned of ROM. Make a small gap of 256 bytes
# between the microcode and the bootblock just in case. Linker may add some
# additional data in the beginning of the bootblock binary.

config C_ENV_BOOTBLOCK_SIZE
	default 0x6300

# Make sure nothing gets in the IBB besides bootblock and microcode, because
# if any CBFS file is put into IBB, it will not be available after
# FW_SHADOW_DONE. Thus we put bootblock into the FMAP region.

config BOOTBLOCK_IN_CBFS
	bool
	default n

if PAYLOAD_SEABIOS

# Need to override the end of CBFS region for SeaBIOS to work properly
# 0xfffdf000 is the beginning address of Key Manifest. If no Key Manifest
# is used, then it may be 0xfffe0000. Of course it also depends on FMAP
# layout.
config SEABIOS_CBFS_LOCATION
	default 0xfffdf000 if TXE_SB_INCLUDE_KEY_MANIFEST
	default 0xfffe0000

endif # PAYLOAD_SEABIOS

endif # TXE_SECURE_BOOT

endif
```

## src/soc/intel/common/block/oc_wdt/Kconfig
```kconfig
config SOC_INTEL_COMMON_BLOCK_OC_WDT
	bool
	depends on SOC_INTEL_COMMON_BLOCK_PMC
	help
	  Intel Processor common Overclocking Watchdog support

config SOC_INTEL_COMMON_OC_WDT_ENABLE
	bool "Enable chipset watchdog during boot"
	depends on SOC_INTEL_COMMON_BLOCK_OC_WDT
	help
	  Enables Intel chipset Overclocking Watchdog to count during system
	  boot. The platform will reset during lockups if watchdog is not
	  reloaded. Software/firmware is responsible for feeding the watchdog.

	  If unsure, say N.

config SOC_INTEL_COMMON_OC_WDT_TIMEOUT
	int "Watchdog timeout in seconds"
	depends on SOC_INTEL_COMMON_OC_WDT_ENABLE
	range 60 1024
	default 90
	help
	  Intel chipset Overclocking Watchdog timeout value in seconds.
	  coreboot will reload the watchdog with timeout value specified
	  in this option. Specify a high enough value so that the platform
	  will have a chance to boot, at least 90 seconds or so. Especially
	  when platform does full memory initialization.

config SOC_INTEL_COMMON_OC_WDT_RELOAD_IN_PERIODIC_SMI
	bool "Feed the watchdog using periodic SMI"
	depends on SOC_INTEL_COMMON_OC_WDT_ENABLE
	depends on SOC_INTEL_COMMON_BLOCK_SMM
	default y
	help
	  Enables Intel chipset Overclocking Watchdog reloading in the periodic
	  SMI handler. Allows to reload the watchdog without support of the
	  watchdog in the payload/software using the periodic SMI handler in
	  coreboot.

	  If unsure, say Y.
```

## src/soc/intel/common/block/smbus/Kconfig
```kconfig
config SOC_INTEL_COMMON_BLOCK_SMBUS
	bool
	select SOUTHBRIDGE_INTEL_COMMON_SMBUS
	help
	  Intel Processor common SMBus support

config FIXED_SMBUS_IO_BASE
	default 0xefa0

config SOC_INTEL_COMMON_BLOCK_TCO
	bool
	help
	  Intel Processor common TCO support

config SOC_INTEL_COMMON_BLOCK_TCO_ENABLE_THROUGH_SMBUS
	bool
	depends on SOC_INTEL_COMMON_BLOCK_TCO
	help
	  Select this config to enable TCO BAR through SMBUS

config SOC_INTEL_COMMON_BLOCK_TCO_WDT_ENABLE
	bool
	depends on SOC_INTEL_COMMON_BLOCK_TCO
	default y
	help
	  Select this config to start the watchdog in coreboot, before the
	  OS has booted.

config SOC_INTEL_COMMON_BLOCK_TCO_WDT_TIMEOUT_SECONDS
	int
	depends on SOC_INTEL_COMMON_BLOCK_TCO_WDT_ENABLE
	range 2 613
	default 60
	help
	  The Intel TCO Watchdog timeout value in seconds. coreboot will preload the
	  watchdog with this value. Specify a high enough value, so that the
	  platform has a chance to complete memory training and boot to an operating
	  system. Default value is 60 seconds.
```
