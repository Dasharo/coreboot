## src/soc/ibm/power9/Kconfig
```kconfig
## SPDX-License-Identifier: GPL-2.0-only

config SOC_IBM_POWER9
	bool
	select ARCH_BOOTBLOCK_PPC64
	select ARCH_VERSTAGE_PPC64
	select ARCH_ROMSTAGE_PPC64
	select ARCH_RAMSTAGE_PPC64
	select DRAM_SUPPORT_DDR4
	help
	  This SoC is the minimal template working on POWER9 Talos II platform.

if SOC_IBM_POWER9

config SIGNING_KEYS_DIR
	string "Directory with OpenPower signing keys"
	default ""
	help
	  Specifies path to directory containing hw_key_{a,b,c}.key
	  and sw_key_p.key files (all in PEM format).  Key name suffixes
	  correspond to options of create-container from OpenPower
	  Signing Utils.  By default, test keys are used.

# Doing delays with monotonic timers is suboptimal on this platform
config GENERIC_UDELAY
	bool
	default n

config SKIP_INITIAL_ECC_SCRUB
	bool "Skip initial ECC scrubbing"
	default n
	help
	  Enabling this option will skip initial ECC scrubbing that is normally
	  done right after memory is written with an initial pattern. This is
	  not the same as clearing memory after init, ECC memory always has to
	  be filled with any value in order to make ECC correct.
	  Selecting this option almost halves the time needed for memory
	  initialization (istep 14.1).

endif
```

## src/superio/nuvoton/nct6796d/Kconfig
```kconfig
# SPDX-License-Identifier: GPL-2.0-only

config SUPERIO_NUVOTON_NCT6796D
	bool
	select SUPERIO_NUVOTON_COMMON_PRE_RAM

config SUPERIO_NUVOTON_NCT6796D_HWM
	bool
	default n
	depends on SUPERIO_NUVOTON_NCT6796D
	help
	  Enable PECI (Intel CPU temperature) and Smart Fan IV fan control
	  for SYSFAN, CPUFAN, and AUXFAN0-4 (7 fans). Requires peci_enable
	  and fan configuration via chip registers in devicetree.
```

## src/vendorcode/pavonis/Kconfig
```kconfig
## SPDX-License-Identifier: GPL-2.0-only
## 3MDEB CONFIDENTIAL

config PAVONIS_LINUXBOOT_APOB_SYNC
	bool "Bundle faux-ipcc APOB sync uinit into the LinuxBoot initramfs"
	depends on PAYLOAD_LINUXBOOT && LINUXBOOT_UROOT
	help
	  Build faux-ipcc (from the 3rdparty/ipcc-rs submodule) as a
	  static musl binary and generate the preboot uinit script, then
	  inject both into the u-root initramfs (bin/faux-ipcc,
	  bin/uinit). The uinit probes for an attached SP over USB serial
	  and syncs the in-DRAM APOB with the SP-side copy via IPCC
	  before handing off to /bbin/boot.

	  The ipcc-rs submodule is marked update=none (private repo);
	  populate it before building with
	  git submodule update --init --checkout 3rdparty/ipcc-rs.

	  Requires a Rust toolchain with the x86_64-unknown-linux-musl
	  target (rustup target add x86_64-unknown-linux-musl) in the
	  build environment.

if PAVONIS_LINUXBOOT_APOB_SYNC

config PAVONIS_PREBOOT_TTY_GLOB
	string "TTY glob to probe for the SP"
	default "/dev/ttyUSB*"
	help
	  Glob of serial devices the preboot uinit probes for the SP.
	  Can be overridden at runtime without rebuilding via
	  uroot.uinitargs="tty_glob=..." on the kernel command line.

endif # PAVONIS_LINUXBOOT_APOB_SYNC
```
