## src/soc/intel/common/block/tcss/Kconfig
```kconfig
config SOC_INTEL_COMMON_BLOCK_TCSS
	def_bool n
	select FSPS_USE_MULTI_PHASE_INIT
	help
	  Sets up USB2/3 port mapping in TCSS MUX.

config ENABLE_TCSS_MUX_DISCONNECT
	def_bool n
	help
	  Set TCSS MUX to disconnect state during boot.

config ENABLE_TCSS_DISPLAY_DETECTION
	bool "Enable detection of displays over USB Type-C ports with TCSS"
	select ENABLE_TCSS_MUX_DISCONNECT
	depends on SOC_INTEL_COMMON_BLOCK_TCSS && RUN_FSP_GOP
	help
	  Enable displays to be detected over Type-C ports during boot.
```

## src/soc/intel/common/pch/lockdown/Kconfig
```kconfig
config SOC_INTEL_COMMON_PCH_LOCKDOWN
	bool
	default n
	select HAVE_INTEL_CHIPSET_LOCKDOWN
	help
	  This option allows to have chipset lockdown for DMI, FAST_SPI and
	  soc_lockdown_config() to implement any additional lockdown as PMC,
	  LPC for supported PCH.

config SOC_INTEL_COMMON_SPI_LOCKDOWN_SMM
	bool "Lock down SPI controller in SMM"
	default n
	depends on HAVE_SMI_HANDLER
	select SPI_FLASH_SMM
	help
	  This option allows to have chipset lockdown for FAST_SPI and LPC for
	  supported PCH. If selected, coreboot will skip locking down the SPI
	  and LPC controller. The payload or OS is responsible for locking it
	  using APM_CNT_FINALIZE SMI. Used by heads to set and lock PR0 flash
	  protection.
	  
	  If unsure, say N.
```

## src/southbridge/amd/sb700/Kconfig
```kconfig
## SPDX-License-Identifier: GPL-2.0-only

config SOUTHBRIDGE_AMD_SB700
	bool

if SOUTHBRIDGE_AMD_SB700

config SOUTHBRIDGE_SPECIFIC_OPTIONS # dummy
	def_bool y
	select IOAPIC
	select HAVE_USBDEBUG_OPTIONS
	select SMBUS_HAS_AUX_CHANNELS
	select HAVE_POWER_STATE_AFTER_FAILURE
	select HAVE_POWER_STATE_PREVIOUS_AFTER_FAILURE
	select SOC_AMD_COMMON # workaround for BIOSRAM needed in amd_mtrr.c


config SOUTHBRIDGE_AMD_SB700_33MHZ_SPI
	bool "Enable high speed SPI clock"
	default n
	help
	  When set, the SPI clock will run at 33MHz instead
	  of the compatibility mode 16.5MHz.  Note that not
	  all ROMs are capable of 33MHz operation, so you
	  will need to verify this option is appropriate for
	  the ROM you are using.

# Set for southbridge SP5100 which also uses SB700 driver
config SOUTHBRIDGE_AMD_SUBTYPE_SP5100
	bool
	default n

config SOUTHBRIDGE_AMD_SB700_SKIP_ISA_DMA_INIT
	bool
	default n

config SOUTHBRIDGE_AMD_SB700_DISABLE_ISA_DMA
	bool
	default n

config SOUTHBRIDGE_AMD_SB700_SATA_PORT_COUNT_BITFIELD
	hex
	default 0xf

config EHCI_BAR
	hex
	default 0xfef00000

config HPET_MIN_TICKS
	hex
	default 0x14

endif # SOUTHBRIDGE_AMD_SB700
```

## src/superio/ite/it8625e/Kconfig
```kconfig
# SPDX-License-Identifier: GPL-2.0-only

config SUPERIO_ITE_IT8625E
	bool
	select SUPERIO_ITE_COMMON_PRE_RAM
	select SUPERIO_ITE_ENV_CTRL
	select SUPERIO_ITE_ENV_CTRL_5FANS
	select SUPERIO_ITE_ENV_CTRL_EXT_ANY_TMPIN
	select SUPERIO_ITE_ENV_CTRL_7BIT_SLOPE_REG
```

## src/vendorcode/Kconfig
```kconfig
source src/vendorcode/amd/Kconfig
#source src/vendorcode/google/Kconfig
#source src/vendorcode/intel/Kconfig
source src/vendorcode/eltan/Kconfig
```

## src/vendorcode/amd/Kconfig
```kconfig
#
# This file is part of the coreboot project.
#
# Copyright (C) 2013-2014 Sage Electronic Engineering, LLC
# Copyright (C) 2015-2016 Eltan B.V.
#
# This program is free software; you can redistribute it and/or modify
# it under the terms of the GNU General Public License as published by
# the Free Software Foundation; version 2 of the License.
#
# This program is distributed in the hope that it will be useful,
# but WITHOUT ANY WARRANTY; without even the implied warranty of
# MERCHANTABILITY or FITNESS FOR A PARTICULAR PURPOSE.  See the
# GNU General Public License for more details.
#
# You should have received a copy of the GNU General Public License
# along with this program; if not, write to the Free Software
# Foundation, Inc., 51 Franklin St, Fifth Floor, Boston, MA 02110-1301 USA
#

if CPU_AMD_PI

menu "AMD Platform Initialization"

source src/vendorcode/amd/pi/Kconfig

config CPU_AMD_AGESA_BINARY_PI
	bool 
	select HUDSON_DISABLE_IMC
	default y
	help
	  Use a binary PI package.  Generally, these will be stored in the
	  "3rdparty" directory.  For some processors, these must be obtained
	  directly from AMD Embedded Processors Group
	  (http://www.amdcom/embedded).

if CPU_AMD_AGESA_BINARY_PI

config AGESA_BINARY_PI_PATH_DEFAULT_SELECTED
	bool
	default n

config AGESA_BINARY_PI_PATH
	string "AGESA PI directory path"
	default AGESA_BINARY_PI_PATH_DEFAULT if AGESA_BINARY_PI_PATH_DEFAULT_SELECTED
	help
	  Specify where to find the AGESA headers and binary file
	  for AMD platform initialization.

config AGESA_BINARY_PI_FILE_DEFAULT_SELECTED
	bool
	default n

config AGESA_BINARY_PI_FILE
	string "AGESA PI binary file name"
	default AGESA_BINARY_PI_FILE_DEFAULT if AGESA_BINARY_PI_FILE_DEFAULT_SELECTED
	help
	  Specify the binary file to use for AMD platform initialization.

config AGESA_BINARY_PI_LOCATION_DEFAULT_SELECTED
	bool
	default n

config AGESA_BINARY_PI_LOCATION
	string "AGESA PI binary address in ROM"
	default AGESA_BINARY_PI_LOCATION_DEFAULT if AGESA_BINARY_PI_FILE_DEFAULT_SELECTED
	help
	  Specify the ROM address at which to store the binary Platform
	  Initialization code.

endif

endmenu

endif
```

## src/vendorcode/dasharo/Kconfig
```kconfig
# SPDX-License-Identifier: GPL-2.0-only

if GENERATE_SMBIOS_TABLES

config BIOS_VENDOR
	default "3mdeb"

endif

comment "Dasharo"

menu "Dasharo Configuration"

config DASHARO_PREFER_S3_SLEEP
	bool "Prefer S3 suspend over S0ix"
	default n if PAYLOAD_EDK2
	default y

endmenu
```

## src/vendorcode/eltan/Kconfig
```kconfig
#
# This file is part of the coreboot project.
#
# Copyright (C) 2014-2016 Eltan BV
#
# This program is free software; you can redistribute it and/or modify
# it under the terms of the GNU General Public License as published by
# the Free Software Foundation; version 2 of the License.
#
# This program is distributed in the hope that it will be useful,
# but WITHOUT ANY WARRANTY; without even the implied warranty of
# MERCHANTABILITY or FITNESS FOR A PARTICULAR PURPOSE.  See the
# GNU General Public License for more details.
#
# You should have received a copy of the GNU General Public License
# along with this program; if not, write to the Free Software
# Foundation, Inc., 51 Franklin St, Fifth Floor, Boston, MA 02110-1301 USA
#

menu "Eltan options"
	depends on USE_OPTION_TABLE

config ELTAN_USE_FIXED_BAUDRATE
	bool "force usage of fixed baudrate for debug console"
	default y
	depends on USE_OPTION_TABLE
	help
	  Enable or disable fixed baudrate for debug output even when cmos is used
	
endmenu
```

## src/vendorcode/intel/Kconfig
```kconfig
## SPDX-License-Identifier: GPL-2.0-only

config UDK_BASE
	def_bool n

config UEFI_2_4_BINDING
	def_bool n
	select UDK_BASE

config UDK_2017_BINDING
	def_bool n
	select UDK_BASE

config UDK_202005_BINDING
	def_bool n
	select UDK_BASE

config UDK_202111_BINDING
	def_bool n
	select UDK_BASE

config UDK_202302_BINDING
	def_bool n
	select UDK_BASE

# The version is user-configurable only if SOC didn't requests a specific one.
# In that case, it can be useful to have these headers to enable EFI-specific
# options when EDK2 payload is in use.
if !UEFI_2_4_BINDING && \
   !UDK_2017_BINDING && \
   !UDK_202005_BINDING && \
   !UDK_202111_BINDING && \
   !UDK_202302_BINDING && \
   PAYLOAD_EDK2

choice
	prompt "Set of UEFI headers to use"

config USE_NO_UEFI_BINDING
	bool "None"
config USE_UEFI_2_4_BINDING
	bool "UEFI 2.4"
	select UDK_BASE
config USE_UDK_2017_BINDING
	bool "UDK 2017"
	select UDK_BASE
config USE_UDK_202005_BINDING
	bool "UDK 202005"
	select UDK_BASE
config USE_UDK_202111_BINDING
	bool "UDK 202111"
	select UDK_BASE
config USE_UDK_202302_BINDING
	bool "UDK 202302"
	select UDK_BASE

endchoice

endif

if UDK_BASE
config UDK_2013_VERSION
	int
	default 2013

config UDK_2017_VERSION
	int
	default 2017

config UDK_202005_VERSION
	int
	default 202005

config UDK_202111_VERSION
	int
	default 202111

config UDK_202302_VERSION
	int
	default 202302

config UDK_VERSION
	int
	default 202302 if UDK_202302_BINDING || USE_UDK_202302_BINDING
	default 202111 if UDK_202111_BINDING || USE_UDK_202111_BINDING
	default 202005 if UDK_202005_BINDING || USE_UDK_202005_BINDING
	default 2017 if UDK_2017_BINDING || USE_UDK_2017_BINDING
	default 2013
	help
	  UEFI Development Kit version for Platform
endif # UDK_BASE
```

## util/autoport/src/mainboard/notebook/Kconfig
```kconfig
if VENDOR_NOTEBOOK

choice
	prompt "Mainboard model"

source "src/mainboard/notebook/*/Kconfig.name"

endchoice

source "src/mainboard/notebook/*/Kconfig"

config MAINBOARD_VENDOR
	string
	default "Notebook"

endif # VENDOR_NOTEBOOK
```
