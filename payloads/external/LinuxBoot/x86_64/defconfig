## src/mainboard/gigabyte/mz33-ar1/Kconfig
```kconfig
## SPDX-License-Identifier: GPL-2.0-only

if BOARD_GIGABYTE_MZ33_AR1

config BOARD_SPECIFIC_OPTIONS
	def_bool y
	select SOC_AMD_TURIN_POC
	select SOC_AMD_COMMON_BLOCK_PSP_RPMC
	select BOARD_ROMSIZE_KB_32768
	select MEMORY_MAPPED_TPM
	select DRIVERS_ASPEED_AST2050
	select SUPERIO_ASPEED_AST2400
	select IPMI_KCS
	select IPMI_KCS_ROMSTAGE
	select DISABLE_KEYBOARD_RESET_PIN
	select SPI_FLASH_FORCE_4_BYTE_ADDR_MODE
	select SYSTEM_TYPE_SERVER
	select HAVE_GIGABYTE_BMC_BIOS_UPDATE
	select HAVE_OPTION_TABLE
	select HAVE_CMOS_DEFAULT

config FMDFILE
	default "src/mainboard/gigabyte/mz33-ar1/vboot-rwab.fmd" if VBOOT && VBOOT_SLOTS_RW_AB
	default "src/mainboard/gigabyte/mz33-ar1/vboot-rwa.fmd" if VBOOT && VBOOT_SLOTS_RW_A
	default "src/mainboard/gigabyte/mz33-ar1/board.fmd"

config MAINBOARD_DIR
	default "gigabyte/mz33-ar1"

config MAINBOARD_SMBIOS_MANUFACTURER
	default "Giga Computing"

config MAINBOARD_PART_NUMBER
	default "MZ33-AR1-000"

config MAINBOARD_SMBIOS_PRODUCT_NAME
	default "MZ33-AR1-000"

config MAINBOARD_SERIAL_NUMBER
	default "01234567890123456789AB"

config MAINBOARD_VERSION
	default "03000300"

config MAINBOARD_FAMILY
	string
	default "Server"

config PSP_EARLY_VGA_IMAGE
	default "src/mainboard/gigabyte/mz33-ar1/early_vga.bin"

config BUILD_WITH_DEBUG_APCB
	bool "Build with debug APCB blobs"
	default n
	help
	  Build coreboot image with debug APCB blobs. When selected, the
	  APCBs with debug output on serial port will be used during build.

	  Enabel it when debugging pre-reset vector issues.

config ECAM_MMCONF_BASE_ADDRESS
	default 0xb0000000

config EFS_SPI_READ_MODE
	default 0	# Normal read 33MHz

config EFS_SPI_SPEED
	default 0	# 66MHz

config EFS_SPI_MICRON_FLAG
	default 0

config NORMAL_READ_SPI_SPEED
	default 1	# 33MHz

config ALT_SPI_SPEED
	default 1	# 33MHz

config TPM_SPI_SPEED
	default 1	# 33MHz

config EFS_ESPI0_CONFIG
	default 0x0e

config TPM_MEASURED_BOOT_INIT_BOOTBLOCK
	default y if TPM_MEASURED_BOOT && !VBOOT

config VBOOT
	select GBB_FLAG_DISABLE_EC_SOFTWARE_SYNC
	select GBB_FLAG_DISABLE_FWMP
	select GBB_FLAG_DISABLE_LID_SHUTDOWN
	select GBB_FLAG_DISABLE_PD_SOFTWARE_SYNC
	select VBOOT_ALWAYS_ENABLE_DISPLAY
	select VBOOT_NO_BOARD_SUPPORT
	select VBOOT_NO_TPM
	select VBOOT_CLEAR_RECOVERY_IN_RAMSTAGE

config VBOOT_SLOTS_RW_AB
	default y if VBOOT

config VBOOT_VBNV_OFFSET
	default 0x60

config DIMM_MAX
	default 24

endif
```

## src/mainboard/hardkernel/odroid-h4/Kconfig
```kconfig
## SPDX-License-Identifier: GPL-2.0-only

if BOARD_HARDKERNEL_ODROID_H4

config BOARD_SPECIFIC_OPTIONS
	def_bool y
	select AZALIA_USE_LEGACY_VERB_TABLE
	select BOARD_ROMSIZE_KB_16384
	select CRB_TPM
	select DRIVERS_UART_8250IO
	select FSP_TYPE_IOT
	select HAVE_ACPI_RESUME
	select HAVE_ACPI_TABLES
	select HAVE_INTEL_PTT
	select INTEL_GMA_HAVE_VBT
	select SUPERIO_ITE_IT8613E
	select SOC_INTEL_ALDERLAKE_PCH_N
	select SOC_INTEL_COMMON_BLOCK_HDA_VERB

config MAINBOARD_DIR
	default "hardkernel/odroid-h4"

config MAINBOARD_PART_NUMBER
	default "ODROID-H4"

config MAINBOARD_VENDOR
	default "HARDKERNEL"

config MAINBOARD_FAMILY
	default "H4"

config DIMM_SPD_SIZE
	default 1024

config DIMM_MAX
	default 2

config UART_FOR_CONSOLE
	default 0

config USE_PM_ACPI_TIMER
	default n

config CBFS_SIZE
	default 0xa00000

config VBOOT
	select GBB_FLAG_DISABLE_EC_SOFTWARE_SYNC
	select GBB_FLAG_DISABLE_FWMP
	select GBB_FLAG_DISABLE_LID_SHUTDOWN
	select GBB_FLAG_DISABLE_PD_SOFTWARE_SYNC
	select VBOOT_ALWAYS_ENABLE_DISPLAY
	select VBOOT_NO_BOARD_SUPPORT
	select HAS_RECOVERY_MRC_CACHE
	select VBOOT_NO_TPM
	select VBOOT_ENABLE_CBFS_FALLBACK
	select VBOOT_CLEAR_RECOVERY_IN_RAMSTAGE

config VBOOT_SLOTS_RW_A
	default y if VBOOT

config SOC_INTEL_CSE_SEND_EOP_EARLY
	default n

config FMDFILE
	default "src/mainboard/\$(CONFIG_MAINBOARD_DIR)/vboot-rwa.fmd" if VBOOT && VBOOT_SLOTS_RW_A

config ODROID_H4_ENABLE_SAGV
	bool "Enable SAGV"
	default y
	help
	  SAGV (System Agent GeyserVille) is Intel's implementation of
	  DVFS (Dynamic Voltage Frequency Scaling) that reduces energy
	  consumption of the SA and DRAM during low-load conditions by
	  automatically switching to lower voltages / frequencies when
	  the system load is low enough. When enabled, memory training
	  has to run multiple times (once per SAGV point), which slows
	  down booting (but only when the MRC cache is unusable).

	  If unsure, keep enabled. If reflashing often, disabling this
	  option can be useful to reduce memory training time.

endif #BOARD_HARDKERNEL_ODROID_H4
```

## src/mainboard/msi/ms7e56/Kconfig
```kconfig
# SPDX-License-Identifier: GPL-2.0-only

if BOARD_MSI_PRO_B850_P

config BOARD_SPECIFIC_OPTIONS
	def_bool y
	select BOARD_ROMSIZE_KB_32768
	select AZALIA_HDA_CODEC_SUPPORT
	select SOC_AMD_PHOENIX_AM5_OPENSIL
	select SOC_AMD_COMMON_BLOCK_HDA
	select SOC_AMD_COMMON_BLOCK_USE_ESPI
	select SOC_AMD_COMMON_BLOCK_ESPI_RETAIN_PORT80_EN
	select SOC_AMD_COMMON_BLOCK_PSP_RPMC
	select SOC_AMD_COMMON_BLOCK_PSP_SMI
	select SPI_FLASH_FORCE_4_BYTE_ADDR_MODE
	select SUPERIO_NUVOTON_NCT6687D
	select SMBIOS_TYPE41_PROVIDED_BY_DEVTREE
	select DRIVERS_UART_8250IO
	select DRIVERS_AMD_PROMONTORY21
	select HAVE_ACPI_TABLES
	select MEMORY_MAPPED_TPM
	select HAVE_X86_64_SUPPORT
	select USE_X86_64_SUPPORT
	select IOAPIC_8BIT_ID
	select IOAPIC_PREDEFINED_ID
	select BOARD_HAS_MSI_ROMHOLE

config FMDFILE
	default "src/mainboard/msi/ms7e56/board.fmd"

config MAINBOARD_DIR
	default "msi/ms7e56"

config MAINBOARD_PART_NUMBER
	default "PRO B850-P WIFI (MS-7E56)"

config MAINBOARD_VENDOR
	default "Micro-Star International Co., Ltd."

config MAINBOARD_FAMILY
	default "Default string"

config MAINBOARD_VERSION
	default "2.0"

config UART_FOR_CONSOLE
	default 0

config DEVICETREE
	default "devicetree.cb"

config VBOOT
	select GBB_FLAG_DISABLE_EC_SOFTWARE_SYNC
	select GBB_FLAG_DISABLE_FWMP
	select GBB_FLAG_DISABLE_LID_SHUTDOWN
	select GBB_FLAG_DISABLE_PD_SOFTWARE_SYNC
	select VBOOT_ALWAYS_ENABLE_DISPLAY
	select VBOOT_NO_BOARD_SUPPORT
	select VBOOT_SEPARATE_VERSTAGE
	select VBOOT_STARTS_IN_BOOTBLOCK

config VBOOT_VBNV_OFFSET
	hex
	default 0x2A

config RO_REGION_ONLY
	string
	depends on VBOOT_SLOTS_RW_AB || VBOOT_SLOTS_RW_A
	default "apu/amdfw"

config EFS_SPI_READ_MODE
	default 5	# Quad IO (1-4-4)

config EFS_SPI_SPEED
	default 0	# 66MHz

config EFS_SPI_MICRON_FLAG
	default 2

config NORMAL_READ_SPI_SPEED
	default 1	# 33MHz

config ALT_SPI_SPEED
	default 0	# 66MHz

config TPM_SPI_SPEED
	default 3	# 16MHz

config CPU_PT_ROM_MAP_GB
	default 1024

config MRC_SETTINGS_CACHE_SIZE
	default 0x1000000

# Do not move this address. It has to match APCB.
config ECAM_MMCONF_BASE_ADDRESS
	default 0xe0000000

config MSI_ROMHOLE_TOOL_FLAGS
	string
	default "-DMSI_ROMHOLE_NO_FDP -DMSI_ROMHOLE_32BIT_LENGTHS -DMSI_ROMHOLE_BUV_SIZE=2048"

endif # BOARD_MSI_PRO_B850_P
```

## src/mainboard/msi/ms7e56/Kconfig.name
```kconfig
## SPDX-License-Identifier: GPL-2.0-only

## SPDX-License-Identifier: GPL-2.0-only

config BOARD_MSI_PRO_B850_P
	bool "PRO B850-P (WIFI)"
```

## src/mainboard/novacustom/Kconfig
```kconfig
## SPDX-License-Identifier: GPL-2.0-only

if VENDOR_NOVACUSTOM

choice
	prompt "Mainboard model"

source "src/mainboard/novacustom/*/Kconfig.name"

endchoice

source "src/mainboard/novacustom/*/Kconfig"
source "src/mainboard/clevo/*/Kconfig"

config MAINBOARD_VENDOR
	default "NovaCustom"

config DGPU_ONLY_AVAILABLE
	bool "dGPU Only mux pin is available"
	default n
	depends on EDK2_DGPU_POWER_OPTION

endif # VENDOR_NOVACUSTOM
```

## src/mainboard/novacustom/nuc_box/Kconfig
```kconfig
## SPDX-License-Identifier: GPL-2.0-only

config BOARD_NOVACUSTOM_NUC_BOX_COMMON
	def_bool n
	select BOARD_ROMSIZE_KB_32768
	select CRB_TPM
	select DRIVERS_GENERIC_CBFS_SERIAL
	select DRIVERS_GENERIC_CBFS_UUID
	select DRIVERS_UART_8250IO
	select HAVE_ACPI_RESUME
	select HAVE_ACPI_TABLES
	select HAVE_CMOS_DEFAULT
	select HAVE_INTEL_PTT
	select HAVE_OPTION_TABLE
	select INTEL_GMA_HAVE_VBT
	select MAINBOARD_HAS_TPM2
	select NO_UART_ON_SUPERIO
	select PCIEXP_SUPPORT_RESIZABLE_BARS
	select SOC_INTEL_COMMON_BLOCK_HDA_VERB
	select SOC_INTEL_CRASHLOG
	select SOC_INTEL_METEORLAKE
	select SPD_READ_BY_WORD

config BOARD_NOVACUSTOM_NUC_BOX
	select BOARD_NOVACUSTOM_NUC_BOX_COMMON
	select SOC_INTEL_ENABLE_USB4_PCIE_RESOURCES
	select SOC_INTEL_METEORLAKE_U_H

if BOARD_NOVACUSTOM_NUC_BOX_COMMON

config MAINBOARD_DIR
	default "novacustom/nuc_box"

config VARIANT_DIR
	default "nuc_box" if BOARD_NOVACUSTOM_NUC_BOX

config OVERRIDE_DEVICETREE
	default "variants/\$(CONFIG_VARIANT_DIR)/overridetree.cb"

config MAINBOARD_PART_NUMBER
	default "NUC BOX" if BOARD_NOVACUSTOM_NUC_BOX

config MAINBOARD_SMBIOS_PRODUCT_NAME
	default "NUC_BOX" if BOARD_NOVACUSTOM_NUC_BOX

config MAINBOARD_VERSION
	default "nuc_box" if BOARD_NOVACUSTOM_NUC_BOX

config MAINBOARD_FAMILY
	string
	default "Not Applicable" # Match Insyde firmware

config CMOS_DEFAULT_FILE
	default "src/mainboard/\$(MAINBOARDDIR)/cmos.default"

config CONSOLE_POST
	default y

config D3COLD_SUPPORT
	default n

config DIMM_SPD_SIZE
	default 1024

config FMDFILE
	default "src/mainboard/\$(CONFIG_MAINBOARD_DIR)/variants/\$(CONFIG_VARIANT_DIR)/board.fmd"

config ONBOARD_VGA_IS_PRIMARY
	default y

config PCIEXP_DEFAULT_MAX_RESIZABLE_BAR_BITS
	default 36

config POST_DEVICE
	default n

config TPM_MEASURED_BOOT
	default y

config UART_FOR_CONSOLE
	default 0

# PM Timer Disabled, saves power
config USE_PM_ACPI_TIMER
	default n

config VBOOT
	select GBB_FLAG_DISABLE_EC_SOFTWARE_SYNC
	select GBB_FLAG_DISABLE_FWMP
	select GBB_FLAG_DISABLE_LID_SHUTDOWN
	select GBB_FLAG_DISABLE_PD_SOFTWARE_SYNC
	select HAS_RECOVERY_MRC_CACHE
	select VBOOT_ALWAYS_ENABLE_DISPLAY
	select VBOOT_CLEAR_RECOVERY_IN_RAMSTAGE
	select VBOOT_MOCK_SECDATA
	select VBOOT_NO_BOARD_SUPPORT
	select VBOOT_NO_TPM

config VBOOT_VBNV_OFFSET
	default 0x28

config VBOOT_FWID_VERSION
	default "\$(CONFIG_LOCALVERSION)"

endif
```

## src/mainboard/novacustom/nuc_box/Kconfig.name
```kconfig
## SPDX-License-Identifier: GPL-2.0-only

config BOARD_NOVACUSTOM_NUC_BOX
	bool "nuc_box"
```

## src/mainboard/oxide/Kconfig
```kconfig
## SPDX-License-Identifier: GPL-2.0-only

if VENDOR_OXIDE

choice
	prompt "Mainboard model"

source "src/mainboard/oxide/*/Kconfig.name"

endchoice

source "src/mainboard/oxide/*/Kconfig"

config MAINBOARD_VENDOR
	default "OXIDE"

endif # VENDOR_OXIDE
```

## src/mainboard/oxide/cosmo/Kconfig
```kconfig
## SPDX-License-Identifier: GPL-2.0-only

if BOARD_OXIDE_COSMO

config BOARD_SPECIFIC_OPTIONS
	def_bool y
	select BOARD_ROMSIZE_KB_32768
	select HAVE_CMOS_DEFAULT
	select HAVE_OPTION_TABLE
	select SOC_AMD_TURIN_POC
	select DISABLE_KEYBOARD_RESET_PIN
	select SPI_FLASH_FORCE_4_BYTE_ADDR_MODE
	select SYSTEM_TYPE_SERVER
	select AMD_SOC_CONSOLE_UART
	select CONSOLE_SERIAL_3000000

config FMDFILE
	default "src/mainboard/oxide/cosmo/board.fmd"

config MAINBOARD_DIR
	default "oxide/cosmo"

config MAINBOARD_PART_NUMBER
	default "Cosmo"

config BUILD_WITH_DEBUG_APCB
	bool "Build with debug APCB blobs"
	default n
	help
	  Build coreboot image with debug APCB blobs. When selected, the
	  APCBs with debug output on serial port will be used during build.

	  Enabel it when debugging pre-reset vector issues.


config ECAM_MMCONF_BASE_ADDRESS
	default 0xb0000000

config EFS_SPI_READ_MODE
	default 0	# Normal read 33MHz

config EFS_SPI_SPEED
	default 0	# 66MHz

config EFS_SPI_MICRON_FLAG
	default 0

config NORMAL_READ_SPI_SPEED
	default 1	# 33MHz

config ALT_SPI_SPEED
	default 1	# 33MHz

config TPM_SPI_SPEED
	default 1	# 33MHz

config EFS_ESPI0_CONFIG
	default 0x00

config EFS_ESPI1_CONFIG
	default 0xff

config DIMM_MAX
	default 12

endif
```

## src/mainboard/oxide/cosmo/Kconfig.name
```kconfig
## SPDX-License-Identifier: GPL-2.0-only

config BOARD_OXIDE_COSMO
	bool "Cosmo"
```
