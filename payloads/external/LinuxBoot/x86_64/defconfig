## payloads/external/LinuxBoot/x86_64/defconfig
```kconfig
# CONFIG_LOCALVERSION_AUTO is not set
CONFIG_KERNEL_XZ=y
CONFIG_SYSVIPC=y
CONFIG_NO_HZ_IDLE=y
CONFIG_HIGH_RES_TIMERS=y
CONFIG_BPF_SYSCALL=y
CONFIG_PREEMPT=y
CONFIG_VIRT_CPU_ACCOUNTING_GEN=y
CONFIG_CGROUPS=y
CONFIG_MEMCG=y
CONFIG_BLK_CGROUP=y
CONFIG_CGROUP_SCHED=y
CONFIG_CGROUP_PIDS=y
CONFIG_CGROUP_RDMA=y
CONFIG_CGROUP_DEVICE=y
CONFIG_CGROUP_CPUACCT=y
CONFIG_CGROUP_PERF=y
CONFIG_RELAY=y
CONFIG_BLK_DEV_INITRD=y
# CONFIG_RD_GZIP is not set
# CONFIG_RD_BZIP2 is not set
# CONFIG_RD_LZMA is not set
# CONFIG_RD_LZO is not set
# CONFIG_RD_LZ4 is not set
CONFIG_CC_OPTIMIZE_FOR_SIZE=y
CONFIG_KEXEC=y
CONFIG_KEXEC_FILE=y
# CONFIG_X86_MPPARSE is not set
# CONFIG_X86_EXTENDED_PLATFORM is not set
# CONFIG_SCHED_OMIT_FRAME_POINTER is not set
# CONFIG_X86_MCE is not set
CONFIG_X86_MSR=y
CONFIG_X86_CPUID=y
# CONFIG_X86_INTEL_MEMORY_PROTECTION_KEYS is not set
# CONFIG_RELOCATABLE is not set
# CONFIG_SUSPEND is not set
# CONFIG_ACPI_REV_OVERRIDE_POSSIBLE is not set
# CONFIG_ACPI_AC is not set
# CONFIG_ACPI_BATTERY is not set
# CONFIG_ACPI_PROCESSOR is not set
# CONFIG_ACPI_TABLE_UPGRADE is not set
# CONFIG_CPU_IDLE is not set
# CONFIG_VIRTUALIZATION is not set
# CONFIG_VMAP_STACK is not set
CONFIG_PARTITION_ADVANCED=y
# CONFIG_MQ_IOSCHED_DEADLINE is not set
# CONFIG_MQ_IOSCHED_KYBER is not set
# CONFIG_SWAP is not set
# CONFIG_SLAB_MERGE_DEFAULT is not set
# CONFIG_COMPAT_BRK is not set
# CONFIG_COMPACTION is not set
CONFIG_USERFAULTFD=y
CONFIG_NET=y
CONFIG_PACKET=y
CONFIG_UNIX=y
CONFIG_INET=y
# CONFIG_WIRELESS is not set
CONFIG_PCI=y
CONFIG_PCIEPORTBUS=y
CONFIG_DEVTMPFS=y
CONFIG_DEVTMPFS_MOUNT=y
# CONFIG_STANDALONE is not set
CONFIG_GOOGLE_FIRMWARE=y
CONFIG_GOOGLE_COREBOOT_TABLE=y
CONFIG_GOOGLE_FRAMEBUFFER_COREBOOT=y
CONFIG_GOOGLE_MEMCONSOLE_COREBOOT=y
CONFIG_GOOGLE_VPD=y
# CONFIG_PNP_DEBUG_MESSAGES is not set
CONFIG_BLK_DEV_LOOP=y
CONFIG_BLK_DEV_NVME=y
CONFIG_NVME_MULTIPATH=y
CONFIG_BLK_DEV_SD=y
# CONFIG_BLK_DEV_BSG is not set
# CONFIG_SCSI_LOWLEVEL is not set
CONFIG_ATA=y
CONFIG_MD=y
CONFIG_BLK_DEV_DM=y
CONFIG_DM_CRYPT=y
CONFIG_NETDEVICES=y
# CONFIG_NET_VENDOR_3COM is not set
# CONFIG_NET_VENDOR_ADAPTEC is not set
# CONFIG_NET_VENDOR_AGERE is not set
# CONFIG_NET_VENDOR_ALACRITECH is not set
# CONFIG_NET_VENDOR_ALTEON is not set
# CONFIG_NET_VENDOR_AMAZON is not set
# CONFIG_NET_VENDOR_AMD is not set
# CONFIG_NET_VENDOR_AQUANTIA is not set
# CONFIG_NET_VENDOR_ARC is not set
# CONFIG_NET_VENDOR_ASIX is not set
# CONFIG_NET_VENDOR_ATHEROS is not set
# CONFIG_NET_VENDOR_BROADCOM is not set
# CONFIG_NET_VENDOR_CADENCE is not set
# CONFIG_NET_VENDOR_CAVIUM is not set
# CONFIG_NET_VENDOR_CHELSIO is not set
# CONFIG_NET_VENDOR_CISCO is not set
# CONFIG_NET_VENDOR_CORTINA is not set
# CONFIG_NET_VENDOR_DAVICOM is not set
# CONFIG_NET_VENDOR_DEC is not set
# CONFIG_NET_VENDOR_DLINK is not set
# CONFIG_NET_VENDOR_EMULEX is not set
# CONFIG_NET_VENDOR_ENGLEDER is not set
# CONFIG_NET_VENDOR_EZCHIP is not set
# CONFIG_NET_VENDOR_FUNGIBLE is not set
# CONFIG_NET_VENDOR_GOOGLE is not set
# CONFIG_NET_VENDOR_HISILICON is not set
# CONFIG_NET_VENDOR_HUAWEI is not set
# CONFIG_NET_VENDOR_I825XX is not set
CONFIG_IXGBE=y
# CONFIG_NET_VENDOR_LITEX is not set
# CONFIG_NET_VENDOR_MARVELL is not set
# CONFIG_NET_VENDOR_MELLANOX is not set
# CONFIG_NET_VENDOR_META is not set
# CONFIG_NET_VENDOR_MICREL is not set
# CONFIG_NET_VENDOR_MICROCHIP is not set
# CONFIG_NET_VENDOR_MICROSEMI is not set
# CONFIG_NET_VENDOR_MICROSOFT is not set
# CONFIG_NET_VENDOR_MUCSE is not set
# CONFIG_NET_VENDOR_MYRI is not set
# CONFIG_NET_VENDOR_NI is not set
# CONFIG_NET_VENDOR_NATSEMI is not set
# CONFIG_NET_VENDOR_NETERION is not set
# CONFIG_NET_VENDOR_NETRONOME is not set
# CONFIG_NET_VENDOR_NVIDIA is not set
# CONFIG_NET_VENDOR_OKI is not set
# CONFIG_NET_VENDOR_PACKET_ENGINES is not set
# CONFIG_NET_VENDOR_PENSANDO is not set
# CONFIG_NET_VENDOR_QLOGIC is not set
# CONFIG_NET_VENDOR_BROCADE is not set
# CONFIG_NET_VENDOR_QUALCOMM is not set
# CONFIG_NET_VENDOR_RDC is not set
# CONFIG_NET_VENDOR_REALTEK is not set
# CONFIG_NET_VENDOR_RENESAS is not set
# CONFIG_NET_VENDOR_ROCKER is not set
# CONFIG_NET_VENDOR_SAMSUNG is not set
# CONFIG_NET_VENDOR_SEEQ is not set
# CONFIG_NET_VENDOR_SILAN is not set
# CONFIG_NET_VENDOR_SIS is not set
# CONFIG_NET_VENDOR_SOLARFLARE is not set
# CONFIG_NET_VENDOR_SMSC is not set
# CONFIG_NET_VENDOR_SOCIONEXT is not set
# CONFIG_NET_VENDOR_STMICRO is not set
# CONFIG_NET_VENDOR_SUN is not set
# CONFIG_NET_VENDOR_SYNOPSYS is not set
# CONFIG_NET_VENDOR_TEHUTI is not set
# CONFIG_NET_VENDOR_TI is not set
# CONFIG_NET_VENDOR_VERTEXCOM is not set
# CONFIG_NET_VENDOR_VIA is not set
# CONFIG_NET_VENDOR_WANGXUN is not set
# CONFIG_NET_VENDOR_WIZNET is not set
# CONFIG_NET_VENDOR_XILINX is not set
# CONFIG_WLAN is not set
CONFIG_SERIAL_8250=y
CONFIG_SERIAL_8250_CONSOLE=y
CONFIG_SERIAL_8250_NR_UARTS=32
CONFIG_SERIAL_8250_RUNTIME_UARTS=32
CONFIG_SERIAL_8250_EXTENDED=y
CONFIG_SERIAL_8250_MANY_PORTS=y
CONFIG_SERIAL_8250_DW=y
CONFIG_SERIAL_DEV_BUS=y
CONFIG_HW_RANDOM_TIMERIOMEM=y
# CONFIG_HW_RANDOM_VIA is not set
CONFIG_TCG_TPM=y
CONFIG_TCG_TIS=y
CONFIG_I2C=y
CONFIG_POWER_SUPPLY=y
# CONFIG_HWMON is not set
CONFIG_MFD_INTEL_LPSS_PCI=y
CONFIG_FB=y
CONFIG_FB_SIMPLE=y
CONFIG_FB_FOREIGN_ENDIAN=y
CONFIG_FB_TILEBLITTING=y
CONFIG_FIRMWARE_EDID=y
CONFIG_FRAMEBUFFER_CONSOLE=y
CONFIG_FRAMEBUFFER_CONSOLE_DETECT_PRIMARY=y
CONFIG_FRAMEBUFFER_CONSOLE_ROTATION=y
CONFIG_USB=y
CONFIG_USB_XHCI_HCD=y
CONFIG_USB_STORAGE=y
CONFIG_USB_UAS=y
CONFIG_MMC=y
CONFIG_MMC_SDHCI=y
CONFIG_MMC_SDHCI_PCI=y
CONFIG_MMC_SDHCI_ACPI=y
CONFIG_MMC_SDHCI_PLTFM=y
CONFIG_SYNC_FILE=y
# CONFIG_VIRTIO_MENU is not set
# CONFIG_X86_PLATFORM_DEVICES is not set
CONFIG_AMD_IOMMU=y
CONFIG_IRQ_REMAP=y
CONFIG_EXT4_FS=y
# CONFIG_DNOTIFY is not set
# CONFIG_INOTIFY_USER is not set
CONFIG_ISO9660_FS=y
CONFIG_JOLIET=y
CONFIG_ZISOFS=y
CONFIG_UDF_FS=y
CONFIG_MSDOS_FS=y
CONFIG_VFAT_FS=y
CONFIG_FAT_DEFAULT_UTF8=y
CONFIG_TMPFS=y
# CONFIG_MISC_FILESYSTEMS is not set
CONFIG_NLS_CODEPAGE_437=y
CONFIG_NLS_ISO8859_1=y
CONFIG_SECURITY_DMESG_RESTRICT=y
CONFIG_FORTIFY_SOURCE=y
CONFIG_CRYPTO_JITTERENTROPY=y
# CONFIG_CRYPTO_HW is not set
CONFIG_FRAME_WARN=1024
# CONFIG_SECTION_MISMATCH_WARN_ONLY is not set
# CONFIG_X86_VERBOSE_BOOTUP is not set
```

## src/cpu/qemu-x86/Kconfig
```kconfig
## SPDX-License-Identifier: GPL-2.0-only

config CPU_QEMU_X86
	bool
	select ARCH_X86
	select HAVE_X86_64_SUPPORT
	select UDELAY_TSC
	select TSC_MONOTONIC_TIMER
	select NEED_SMALL_2MB_PAGE_TABLES	# QEMU doesn't support 1GB pages
	select IDT_IN_EVERY_STAGE

if CPU_QEMU_X86

# coreboot i440fx does not support SMM
choice
	prompt "SMM support"
	default CPU_QEMU_X86_ASEG_SMM
	depends on BOARD_EMULATION_QEMU_X86_Q35

config CPU_QEMU_X86_NO_SMM
	bool "No SMM"
	select NO_SMM

config CPU_QEMU_X86_ASEG_SMM
	bool "SMM in ASEG"
	select SMM_ASEG

config CPU_QEMU_X86_TSEG_SMM
	bool "SMM in TSEG"
	select SMM_TSEG

endchoice

config SMM_TSEG_SIZE
	hex
	depends on SMM_TSEG
	default 0x800000 if BOARD_EMULATION_QEMU_X86_Q35
	default 0x100000
	help
	  qemu-q35 S3 resume stashes postcar and ramstage in TSEG
	  (TSEG_STAGE_CACHE). This must be larger than SMM_RESERVED_SIZE.
	  Romstage programs ICH9 ESMRAMC for 1, 2, or 8 MiB.

config SMM_RESERVED_SIZE
	hex
	depends on SMM_TSEG
	default 0x200000 if BOARD_EMULATION_QEMU_X86_Q35
	help
	  External stage-cache subregion at the top of TSEG. qemu-q35 did
	  not set this (0), so HAVE_ACPI_RESUME detected S3 and then
	  postcar_cache_invalid() reset. Size for postcar plus ramstage
	  minus HEAP_SIZE.

config MAX_CPUS
	int
	default 32 if SMM_TSEG
	default 4

endif
```

## src/drivers/amd/promontory21/Kconfig
```kconfig
# SPDX-License-Identifier: GPL-2.0-only

config DRIVERS_AMD_PROMONTORY21
	bool
	help
	  Enable AMD Promontory21 chip driver.
```

## src/drivers/efi/Kconfig
```kconfig
## SPDX-License-Identifier: GPL-2.0-only

config DRIVERS_EFI_VARIABLE_STORE
	bool "Include EFI variable store driver"
	select UDK_2017_BINDING if !PLATFORM_USES_FSP2_0
	help
	  Adds a driver that is able to read and write an EFI formatted
	  VariableStore as used by tianocore.

config DRIVERS_EFI_FW_INFO
	bool "Expose firmware version in a EFI-friendly form"
	select UDK_2017_BINDING if !PLATFORM_USES_FSP2_0
	help
	  Adds firmware version information to coreboot table in a form similar to
	  EFI System Resource Table (ESRT) that can be used for firmware updates.

config DRIVERS_EFI_MAIN_FW_GUID
	string "GUID of the firmware"
	default "00112233-4455-6677-8899-aabbccddeeff"
	depends on DRIVERS_EFI_FW_INFO
	help
	  GUID used to identify firmware kind for the purposes of updates.

config DRIVERS_EFI_MAIN_FW_VERSION
	hex "Version of the firmware"
	range 0x00000000 0xFFFFFFFF
	default 0x00000000
	depends on DRIVERS_EFI_FW_INFO
	help
	  32-bit unsigned integer representing current firmware's version.

config DRIVERS_EFI_MAIN_FW_LSV
	hex "Lowest supported firmware version"
	range 0x00000000 0xFFFFFFFF
	default 0x00000000
	depends on DRIVERS_EFI_FW_INFO
	help
	  32-bit unsigned integer representing lowest firmware version number
	  that is allowed to replace the current one.  Can be used to forbid
	  bugged versions.

config DRIVERS_EFI_EC_FW_GUID
	string "GUID of the EC firmware"
	default ""
	# version of an EC can't be hard-coded, hence must depend on a way to query it
	depends on DRIVERS_EFI_FW_INFO && EC_DASHARO_EC
	help
	  GUID used to identify EC firmware kind for the purposes of updates.
	  An empty value implies there is no EC or it's not updated via a dedicated
	  capsule.

config DRIVERS_EFI_EC_FW_LSV
	hex "Lowest supported EC firmware version"
	range 0x00000000 0xFFFFFFFF
	default 0x00000000
	depends on DRIVERS_EFI_EC_FW_GUID != ""
	help
	  32-bit unsigned integer representing lowest EC firmware version number
	  that is allowed to replace the current one.  Can be used to forbid
	  bugged versions.

config DRIVERS_EFI_EC_FW_SIZE
	hex "Size of the EC firmware"
	# the upper limit is chosen at random merely to exclude obviously wrong values,
	# the lower limit and default value are zero because nothing in coreboot depends on
	# knowing the size
	range 0x00000000 0x00100000
	default 0x00000000
	depends on DRIVERS_EFI_EC_FW_GUID != ""
	help
	  Size of EC firmware image in bytes.

config DRIVERS_EFI_UPDATE_CAPSULES
	bool "Include EFI update capsules driver"
	depends on DRIVERS_EFI_VARIABLE_STORE && SMMSTORE_V2 && DRIVERS_EFI_FW_INFO
	select FAST_SPI_FULL_RO_BOOTMEDIA if SOC_INTEL_COMMON_BLOCK
	select DASHARO_FIRMWARE_UPDATE_MODE
	help
	  Adds a driver that is able to parse CapsuleUpdateData* EFI variables
	  to discover firmware updates and expose them for tianocore thorough
	  CBMEM for execution.  tianocore is responsible for erasing the variables.
```

## src/drivers/pc80/rtc/Kconfig
```kconfig
## SPDX-License-Identifier: GPL-2.0-only

config DRIVERS_MC146818
	bool
	default y if ARCH_X86
	depends on PC80_SYSTEM

config USE_PC_CMOS_ALTCENTURY
	bool "Use legacy-BIOS alt-century byte in CMOS"
	default y if !USE_OPTION_TABLE
	depends on DRIVERS_MC146818
	help
	  May be useful for legacy OSes that assume its presence.

config PC_CMOS_BASE_PORT_BANK0
	hex
	default 0x70

config PC_CMOS_BASE_PORT_BANK1
	hex
	default 0x72

config RESET_OPTIONS_ON_CMOS_CLEAR
	bool "Reset firmware settings when the CMOS is cleared"
	depends on DRIVERS_MC146818
	depends on DRIVERS_EFI_VARIABLE_STORE
	depends on SMMSTORE_V2
	help
	  Treat a loss of the CMOS contents, e.g. because the coin cell was
	  removed, as a request to restore the default firmware settings.

	  The option region is erased so that the payload repopulates it with
	  its defaults, and until that has happened every option read falls
	  back to its compiled-in default. Because the readers are guarded and
	  not just the storage, this also covers the options consumed before
	  ramstage, so a setting that prevents the platform from booting can be
	  recovered by removing and reinserting the coin cell.

	  Say n if the platform has no reliable indication that the RTC well
	  lost power, as the settings would then be discarded on every boot.
```

## src/drivers/tpm/Kconfig
```kconfig
## SPDX-License-Identifier: GPL-2.0-only

config TPM_INIT_RAMSTAGE
	bool
	default y if TPM
	depends on (!VBOOT || VBOOT_NO_TPM) && !VENDORCODE_ELTAN_VBOOT \
		&& !VENDORCODE_ELTAN_MBOOT && !TPM_MEASURED_BOOT_INIT_BOOTBLOCK
	help
	  This driver automatically initializes the TPM if vboot is not used.
	  The TPM driver init is done during the ramstage chip init phase.

config TPM_PPI
	bool "Generate ACPI code to implement TPM physical presence interface"
	depends on TPM
	depends on HAVE_ACPI_TABLES
	depends on !CHROMEOS
	default y if PAYLOAD_EDK2
	help
	  This driver automatically generates ACPI tables for the Physical
	  Presence Interface defined by the TCG. If not activated only a stub
	  will be generated without any functionality.

config TPM_PPI_UEFIVAR_BACKED
	bool "Use EFI variables to convey TPM PPI request"
	depends on TPM_PPI
	depends on DRIVERS_EFI_VARIABLE_STORE && SMMSTORE_V2
	help
	  Select this option to use UEFI variables to convey TPM PPI request
	  information from ACPI to pre-OS environement. Sometimes the request
	  may not survive warm reboto in CBMEM memory on certain platforms.
	  That is when this option becomes helpful.
```

## src/mainboard/asrock/turind8ud-2t/Kconfig
```kconfig
## SPDX-License-Identifier: GPL-2.0-only

if BOARD_ASROCK_TURIND8UD_2T

config BOARD_SPECIFIC_OPTIONS
	def_bool y
	select BOARD_ROMSIZE_KB_32768
	select DISABLE_KEYBOARD_RESET_PIN
	select DRIVERS_ASPEED_AST2050
	select HAVE_CMOS_DEFAULT
	select HAVE_OPTION_TABLE
	select IPMI_KCS
	select IPMI_KCS_ROMSTAGE
	select MEMORY_MAPPED_TPM
	select SOC_AMD_TURIN_POC
	select SPI_FLASH_FORCE_4_BYTE_ADDR_MODE
	select SUPERIO_ASPEED_AST2400
	select SUPERIO_NUVOTON_NCT6796D
	select SYSTEM_TYPE_SERVER

config FMDFILE
	default "src/mainboard/asrock/turind8ud-2t/vboot-rwab.fmd" if VBOOT && VBOOT_SLOTS_RW_AB
	default "src/mainboard/asrock/turind8ud-2t/vboot-rwa.fmd" if VBOOT && VBOOT_SLOTS_RW_A
	default "src/mainboard/asrock/turind8ud-2t/board.fmd"

config MAINBOARD_DIR
	default "asrock/turind8ud-2t"

config MAINBOARD_PART_NUMBER
	default "FIXME"

config PSP_EARLY_VGA_IMAGE
	default "src/mainboard/asrock/turind8ud-2t/early_vga.bin"

config BUILD_WITH_DEBUG_APCB
	bool "Build with debug APCB blobs"
	default n
	help
	  Build coreboot image with debug APCB blobs. When selected, the
	  APCBs with debug output on serial port will be used during build.

	  Enabel it when debugging pre-reset vector issues.

config ECAM_MMCONF_BASE_ADDRESS
	default 0xb0000000

config EFS_SPI_READ_MODE
	default 0	# Normal read

config EFS_SPI_SPEED
	default 2	# 22MHz

config EFS_SPI_MICRON_FLAG
	default 0

config NORMAL_READ_SPI_SPEED
	default 2	# 22MHz

config ALT_SPI_SPEED
	default 2	# 22MHz

config TPM_SPI_SPEED
	default 2	# 22MHz

config EFS_ESPI0_CONFIG
	default 0x0e

config EFS_ESPI1_CONFIG
	default 0x2c

config TPM_MEASURED_BOOT_INIT_BOOTBLOCK
	default y if TPM_MEASURED_BOOT && !VBOOT

config VBOOT
	select GBB_FLAG_DISABLE_EC_SOFTWARE_SYNC
	select GBB_FLAG_DISABLE_FWMP
	select GBB_FLAG_DISABLE_LID_SHUTDOWN
	select GBB_FLAG_DISABLE_PD_SOFTWARE_SYNC
	select VBOOT_ALWAYS_ENABLE_DISPLAY
	select VBOOT_NO_BOARD_SUPPORT
	select VBOOT_NO_TPM
	select VBOOT_CLEAR_RECOVERY_IN_RAMSTAGE

config VBOOT_SLOTS_RW_AB
	default y if VBOOT

config VBOOT_VBNV_OFFSET
	default 0x60

endif
```

## src/mainboard/clevo/Kconfig
```kconfig
## SPDX-License-Identifier: GPL-2.0-only

if VENDOR_CLEVO

choice
	prompt "Mainboard model"

source "src/mainboard/clevo/*/Kconfig.name"

endchoice

source "src/mainboard/clevo/*/Kconfig"

config MAINBOARD_VENDOR
	default "Clevo"

config DGPU_ONLY_AVAILABLE
	bool "dGPU Only mux pin is available"
	default n
	depends on EDK2_DGPU_POWER_OPTION

endif # VENDOR_CLEVO
```
