## src/security/intel/Kconfig
```kconfig
# SPDX-License-Identifier: GPL-2.0-only

source "src/security/intel/acm/Kconfig"
source "src/security/intel/txt/Kconfig"
source "src/security/intel/stm/Kconfig"
source "src/security/intel/cbnt/Kconfig"
```

## src/security/intel/acm/Kconfig
```kconfig
# SPDX-License-Identifier: GPL-2.0-only

config INTEL_ACM
	def_bool n
	help
	  Support for Intel Authenticated Code Modules (ACMs).

if INTEL_ACM

config INTEL_TXT_BIOSACM_FILE
	string "BIOS ACM file"
	default "3rdparty/blobs/soc/intel/skylake/biosacm.bin" if SOC_INTEL_COMMON_SKYLAKE_BASE
	help
	  Intel TXT BIOS ACM file. This file can be obtained through privileged
	  access to Intel resources. Or for some platforms found inside the
	  blob repository.

config INTEL_TXT_SINITACM_FILE
	string "SINIT ACM file"
	default "3rdparty/blobs/soc/intel/skylake/sinitacm.bin" if SOC_INTEL_COMMON_SKYLAKE_BASE
	help
	  Intel TXT SINIT ACM file. This file can be obtained through privileged
	  access to Intel resources. Or for some platforms found inside the
	  blob repository.

config INTEL_TXT_BIOSACM_ALIGNMENT
	hex
	default 0x40000 if INTEL_CBNT_SUPPORT
	default 0x20000 # 128 KiB
	help
	  Exceptions are Ivy and Sandy Bridge with 64 KiB and Purley with 256 KiB
	  alignment size. If necessary, override from platform-specific Kconfig.

config INTEL_TXT_CBFS_BIOS_ACM
	string
	default "txt_bios_acm.bin"

config INTEL_TXT_CBFS_SINIT_ACM
	string
	default "txt_sinit_acm.bin"

config INTEL_TXT_SINIT_SIZE
	hex
	default 0x20000
	help
	  This is the size that will be programmed in TXT_SINIT_SIZE.
	  This needs to be at least the size of the SINIT ACM.
	  This is platform dependent. For instance on CPX this has
	  to be the ACM size + 64K.

endif # INTEL_ACM
```

## src/security/intel/txt/Kconfig
```kconfig
# SPDX-License-Identifier: GPL-2.0-only

config INTEL_TXT_LIB
	bool
	default n
	help
	  This option includes library functions related to the TXT
	  operation which SoC would still like to access without enabling
	  INTEL_TXT config.

config INTEL_TXT
	bool "Intel TXT support"
	default n
	select INTEL_ACM
	select INTEL_TXT_LIB
	select MRC_SETTINGS_PROTECT if CACHE_MRC_SETTINGS
	select ENABLE_VMX if CPU_INTEL_COMMON
	select AP_IN_SIPI_WAIT
	select TPM_MEASURED_BOOT_INIT_BOOTBLOCK if TPM_MEASURED_BOOT
	select TPM_STARTUP_IGNORE_POSTINIT
	depends on TPM
	depends on PLATFORM_HAS_DRAM_CLEAR
	depends on (SOC_INTEL_COMMON_BLOCK_SA || HAVE_CF9_RESET)

if INTEL_TXT

config INTEL_TXT_DPR_SIZE
	int
	range 0 255
	default 3
	help
	  Specify the size the DPR region needs to have. On at least Haswell,
	  the MRC does not have an input to specify the size of DPR, so this
	  field is only used to check if the programmed size is large enough.

config INTEL_TXT_BDR_VERSION
	int "BIOS Data Region version"
	range 2 6
	default 5 if TPM1
	default 6 if TPM2
	help
	  Specify the TXT heap BIOS Data Region version. Sometimes when using
	  an older Trusted Boot version, it may report unsupported BIOS Data
	  Region version and refuse to set up the measured launch environment.
	  Setting lower version may work around such issue. Allowed values
	  currently range from 2 to 6.

config INTEL_TXT_TEST_BIOS_ACM_CALLING_CODE
	bool "Test BIOS ACM calling code with NOP function"
	help
	  Run a NOP function of the BIOS ACM to check that the ACM calling code
	  is functioning properly. Use in pre-production environments only!

config INTEL_TXT_LOGGING
	bool "Enable verbose logging"
	help
	  Print more TXT related debug output.
	  Use in pre-production environments only!

config INTEL_TXT_CBFS_BIOS_POLICY
	string
	default "txt_bios_policy.bin"

config INTEL_TXT_HEAP_SIZE
	hex
	default 0xe0000
	help
	  This is the size that will be programmed in TXT_HEAP_SIZE.
	  This is platform dependent.

endif
```

## src/soc/amd/common/block/iommu/Kconfig
```kconfig
## SPDX-License-Identifier: GPL-2.0-only

config SOC_AMD_COMMON_BLOCK_IOMMU
	bool
	help
	  Select this option to use AMD common IOMMU support.

config SOC_AMD_COMMON_BLOCK_IOMMU_HAS_VF_BARS
	bool
	depends on SOC_AMD_COMMON_BLOCK_IOMMU
	help
	  Select this option to allocate and program AMD IOMMU VF BARs.
	  This is only available on servers.
```

## src/soc/amd/common/block/pci/Kconfig
```kconfig
## SPDX-License-Identifier: GPL-2.0-only

config SOC_AMD_COMMON_BLOCK_PCI
	bool
	select SOC_AMD_COMMON_BLOCK_PCI_MMCONF
	help
	  This option builds functions used to program PCI interrupt
	  routing, both PIC and APIC modes.

config SOC_AMD_COMMON_BLOCK_PCI_MMCONF
	bool
	help
	  Selecting this option adds the AMD-common enable_pci_mmconf function
	  to the build.

config SOC_AMD_COMMON_BLOCK_PCI_MMCONF_SYNC_WITH_DF
	bool
	depends on SOC_AMD_COMMON_BLOCK_PCI_MMCONF
	help
	  Selecting this option to synchronize the PCI MMCONF base address in
	  Data Fabric PCI configuration space. Besides setting the MMCONF MSR,
	  the PCI MMCONF base address must also match the Data Fabric
	  configuration programmed by PSP in ABL. A mismatch between MSR and
	  DF will cause the PCI access via MMCONF to fail. When this option
	  is selected the boards do not have to worry about the coreboot's
	  ECAM_MMCONF_BASE_ADDRESS value and PSP programmed MMCONF, because
	  coreboot will overwrite what PSP has configured in ABL.

config SOC_AMD_COMMON_BLOCK_PCIE_GPP_DRIVER
	bool
	depends on SOC_AMD_COMMON_BLOCK_PCI
	help
	  Select this option to use AMD common PCIe GPP driver.

config SOC_AMD_COMMON_BLOCK_PCI_DOMAIN_ROOT_PRT
	bool
	depends on SOC_AMD_COMMON_BLOCK_PCI
	depends on HAVE_ACPI_TABLES
	help
	  After pci_domain_fill_ssdt(), emit Method(_PRT) on the PCI host bridge
	  scope for root-bus devices (e.g. PCIe root ports) using
	  get_pci_routing_table(). Needed when the SoC ACPI sources do not supply
	  PCI0._PRT.
```

## src/soc/amd/common/skl/Kconfig
```kconfig
# SPDX-License-Identifier: GPL-2.0-only

config LAUNCH_DRTM_PAYLOAD
	bool "Launch DRTM payload before the real one"
	default n
	depends on MEMORY_MAPPED_TPM && ARCH_RAMSTAGE_X86_32
	help
	  Launch DRTM payload before the real one. This makes it possible to
	  put root of trust in hardware for platforms that don't support SRTM.

if LAUNCH_DRTM_PAYLOAD

config SKL_REPOSITORY
	string "URL to git repository for secure-kernel-loader"
	default "https://github.com/TrenchBoot/secure-kernel-loader.git"
	help
	  TODO

config SKL_TAG_OR_REV
	string "Insert a commit's SHA-1 or a branch name"
	default "de1899007d038eeacf5edb8e63c0f0a4b3e265c4"
	help
	  The commit's SHA-1 or branch name of the revision to use. This must exist in
	  SKL_REPOSITORY, and in the case of a branch name, prefixed with origin i.e.
	  "origin/skl-loader-amdsl-v11"

endif # LAUNCH_DRTM_PAYLOAD
```
