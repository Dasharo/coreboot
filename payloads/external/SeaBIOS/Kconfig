## src/mainboard/clevo/mtl-h/Kconfig
```kconfig
config BOARD_CLEVO_MTLH_COMMON
	def_bool n
	select BOARD_ROMSIZE_KB_32768
	select DRIVERS_GENERIC_BAYHUB_LV2
	select DRIVERS_I2C_HID
	select DRIVERS_INTEL_PMC
	select DRIVERS_INTEL_USB4_RETIMER
	select DRIVERS_WIFI_GENERIC
	select EC_ACPI
	select EC_SYSTEM76_EC
	select HAVE_ACPI_RESUME
	select HAVE_ACPI_TABLES
	select HAVE_CMOS_DEFAULT
	select HAVE_OPTION_TABLE
	select INTEL_GMA_HAVE_VBT
	select MAINBOARD_HAS_TPM2
	select MEMORY_MAPPED_TPM
	select NO_UART_ON_SUPERIO
	select PMC_IPC_ACPI_INTERFACE
	select SOC_INTEL_COMMON_BLOCK_HDA_VERB
	select SOC_INTEL_CRASHLOG
	select SOC_INTEL_CSE_PRE_CPU_RESET_TELEMETRY_V2
	select SOC_INTEL_ENABLE_USB4_PCIE_RESOURCES
	select SOC_INTEL_METEORLAKE_U_H
	select SPD_READ_BY_WORD
	select SYSTEM_TYPE_LAPTOP

config BOARD_CLEVO_V5X0TNX_BASE
	bool
	select EC_SYSTEM76_EC_DGPU
	select BOARD_CLEVO_MTLH_COMMON

config BOARD_CLEVO_V540TNX
	bool
	select BOARD_CLEVO_V5X0TNX_BASE

config BOARD_CLEVO_V560TNX
	bool
	select BOARD_CLEVO_V5X0TNX_BASE

config BOARD_CLEVO_V5X0TU_BASE
	bool
	select MAINBOARD_USES_IFD_GBE_REGION
	select BOARD_CLEVO_MTLH_COMMON

config BOARD_CLEVO_V540TU
	bool
	select BOARD_CLEVO_V5X0TU_BASE

config BOARD_CLEVO_V560TU
	bool
	select BOARD_CLEVO_V5X0TU_BASE

if BOARD_CLEVO_MTLH_COMMON

config MAINBOARD_DIR
	default "clevo/mtl-h"

config VARIANT_DIR
	default "igpu" if BOARD_CLEVO_V5X0TU_BASE
	default "dgpu" if BOARD_CLEVO_V5X0TNX_BASE

config OVERRIDE_DEVICETREE
	default "variants/\$(CONFIG_VARIANT_DIR)/overridetree.cb"

config MAINBOARD_PART_NUMBER
	default "V54x_6x_TU" if BOARD_CLEVO_V5X0TU_BASE
	default "V5xTNC_TND_TNE" if BOARD_CLEVO_V5X0TNX_BASE

config MAINBOARD_SMBIOS_PRODUCT_NAME
	default "V54x_6x_TU" if BOARD_CLEVO_V5X0TU_BASE
	default "V5xTNC_TND_TNE" if BOARD_CLEVO_V5X0TNX_BASE

config MAINBOARD_SMBIOS_MANUFACTURER
	default "Notebook"

config MAINBOARD_VERSION
	default "V540TU" if BOARD_CLEVO_V540TU
	default "V560TU" if BOARD_CLEVO_V560TU
	default "V540TNx" if BOARD_CLEVO_V540TNX
	default "V560TNx" if BOARD_CLEVO_V560TNX

config MAINBOARD_FAMILY
	string
	default "Not Applicable" # Match Insyde firmware

config CBFS_SIZE
	default 0xA00000

config CONSOLE_POST
	default y

config DIMM_SPD_SIZE
	default 1024

config ONBOARD_VGA_IS_PRIMARY
	default y

config POST_DEVICE
	default n

config UART_FOR_CONSOLE
	default 0

config USE_PM_ACPI_TIMER
	default n

config VBOOT
	select GBB_FLAG_DISABLE_EC_SOFTWARE_SYNC
	select GBB_FLAG_DISABLE_FWMP
	select GBB_FLAG_DISABLE_LID_SHUTDOWN
	select GBB_FLAG_DISABLE_PD_SOFTWARE_SYNC
	select HAS_RECOVERY_MRC_CACHE
	select VBOOT_ALWAYS_ENABLE_DISPLAY
	select VBOOT_CLEAR_RECOVERY_IN_RAMSTAGE
	select VBOOT_MOCK_SECDATA
	select VBOOT_NO_BOARD_SUPPORT

config VBOOT_SLOTS_RW_AB
	default y if VBOOT

config VBOOT_VBNV_OFFSET
	default 0x28

config TPM_PIRQ
	default 0x61 # GPP_E01

config FMDFILE
	default "src/mainboard/\$(CONFIG_MAINBOARD_DIR)/vboot-rwa.fmd" if VBOOT && VBOOT_SLOTS_RW_A
	default "src/mainboard/\$(CONFIG_MAINBOARD_DIR)/vboot-rwab.fmd" if VBOOT && VBOOT_SLOTS_RW_AB

config SOC_INTEL_CSE_SEND_EOP_EARLY
	default n

config VBOOT_FWID_VERSION
	default "\$(CONFIG_LOCALVERSION)"

config EC_SYSTEM76_EC_FLASH_SIZE
	default 0x40000

if PAYLOAD_EDK2

config EDK2_CPU_THROTTLING_THRESHOLD_DEFAULT
	default 30

endif

endif
```

## src/mainboard/clevo/mtl-h/Kconfig.name
```kconfig
comment "Meteor Lake H"

config BOARD_CLEVO_V540TNX
	bool "V540TU (14\", discrete graphics)"

config BOARD_CLEVO_V560TNX
	bool "V560TU (16\", discrete graphics)"

config BOARD_CLEVO_V540TU
	bool "V540TU (14\", integrated graphics)"

config BOARD_CLEVO_V560TU
	bool "V560TU (16\", integrated graphics)"
```
