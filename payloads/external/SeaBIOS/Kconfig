## payloads/external/SeaBIOS/Kconfig
```kconfig
if PAYLOAD_SEABIOS

choice
	prompt "SeaBIOS repo"
	default SEABIOS_PCENGINES
	depends on PAYLOAD_SEABIOS

config SEABIOS_GENERIC
	bool "SeaBiosRepo"
	help
		Get SeaBIOS from the master GIT repo

config SEABIOS_PCENGINES
	bool "PC Engines Repo"
	help
		Get SeaBIOS from the PC Engines Repo

endchoice

choice
	prompt "SeaBIOS version"
	default SEABIOS_STABLE
	depends on PAYLOAD_SEABIOS

config SEABIOS_STABLE
	bool "Stable version (1.11.0.6 for std)"
	help
	  Stable SeaBIOS version

config SEABIOS_MASTER
	bool "master"
	help
	  Newest SeaBIOS version

config SEABIOS_REVISION
	bool "git revision"
	help
	  Select this option if you have a specific commit or branch
	  that you want to use as the revision from which to
	  build SeaBIOS.

	  You will be able to specify the name of a branch or a commit id
	  later.

endchoice

config SEABIOS_REVISION_ID
	string "Insert a commit's SHA-1 or a branch name"
	depends on SEABIOS_REVISION
	default "origin/master"
	help
	   The commit's SHA-1 or branch name of the revision to use.

config SEABIOS_ADD_SERCON_PORT_FILE
	prompt "Add SeaBIOS sercon-port file to CBFS"
	default n
	bool
	help
	  Select this option to enable SeaBIOS' VGA adapter emulation
	  on serial port.

config SEABIOS_SERCON_PORT_ADDR
	hex "SeaBIOS sercon-port base address"
	depends on SEABIOS_ADD_SERCON_PORT_FILE
	default TTYS0_BASE
	help
	  Set this field to the IO address of a serial port for SeaBIOS' VGA
	  adapter emulation.

	  By default primary console UART defined by TTYS0_BASE is used.

config SEABIOS_PS2_TIMEOUT
	prompt "PS/2 keyboard controller initialization timeout (milliseconds)"
	default 0
	depends on EXPERT
	int
	help
		Some PS/2 keyboard controllers don't respond to commands immediately
		after powering on. This specifies how long SeaBIOS will wait for the
		keyboard controller to become ready before giving up.

config SEABIOS_THREAD_OPTIONROMS
	prompt "Hardware init during option ROM execution"
	default n
	bool
	help
		Allow hardware init to run in parallel with optionrom execution.

		This can reduce boot time, but can cause some timing
		variations during option ROM code execution. It is not
		known if all option ROMs will behave properly with this option.

config SEABIOS_MALLOC_UPPERMEMORY
	bool
	default y
	help
		Use the "Upper Memory Block" area (0xc0000-0xf0000) for internal
		"low memory" allocations.  If this is not selected, the memory is
		instead allocated from the "9-segment" (0x90000-0xa0000).
		This is not typically needed, but may be required on some platforms
		to allow USB and SATA buffers to be written correctly by the
		hardware.  In general, if this is desired, the option will be
		set to 'N' by the chipset Kconfig.

config SEABIOS_VGA_COREBOOT
	prompt "Include generated option rom that implements legacy VGA BIOS compatibility"
	default n
	depends on !VGA_BIOS && (MAINBOARD_DO_NATIVE_VGA_INIT || MAINBOARD_HAS_NATIVE_VGA_INIT_TEXTMODECFG || FSP_GRAPHICS_INIT)
	bool
	help
		Coreboot can initialize the GPU of some mainboards.

		After initializing the GPU, the information about it can be passed to the payload.
		Provide an option rom that implements this legacy VGA BIOS compatibility requirement.

config PAYLOAD_FILE
	default "payloads/external/SeaBIOS/seabios/out/bios.bin.elf"

config PAYLOAD_VGABIOS_FILE
	string
	depends on SEABIOS_VGA_COREBOOT
	default "payloads/external/SeaBIOS/seabios/out/vgabios.bin"

config SEABIOS_DEBUG_LEVEL
	int "SeaBIOS debug level (verbosity)"
	default -1
	help
	  The higher the number, the more verbose SeaBIOS will be. See the table
	  below for the current values corresponding to various items as of SeaBIOS
	  version 1.10.1. Set this value to -1 to use SeaBIOS' default.

	  Output at various SeaBIOS log levels:
	  level 0  - Logging disabled
	  level 1  - Basic output, interrupts 5, 18h, 19h, 40h, SMP, PNP, PMM
	  level 2  - AHCI, Floppy, Basic ps2, interrupts 11h, 12h, 14h, 17h
	  level 3  - bootsplash, initializations, SeaBIOS VGA BIOS interrupts
	  level 4  - bios tables, more optionrom
	  level 5  - Extra bootsplash, more XHCI
	  level 6  - ATA commands, extra optionrom
	  level 7  - extra ps2 commands, more OHCI & EHCI
	  level 8  - extra malloc info, more AHCI
	  level 9  - interrupts 15h, 16h, 1ah, APM, PCI, SMIs, PCIBIOS,
	             USB-HID commands, SDcard commands, Floppy commands
	  level 10 - interrupt 13h (Drives other than floppy)
	  level 20 - interrupt 10h (Display)

comment "Using default SeaBIOS log level"
	depends on SEABIOS_DEBUG_LEVEL = -1

comment "SeaBIOS logging disabled"
	depends on SEABIOS_DEBUG_LEVEL = 0

endif
```
