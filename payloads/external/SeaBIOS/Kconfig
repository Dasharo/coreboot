## payloads/external/tianocore/Kconfig
```kconfig
if PAYLOAD_TIANOCORE

config PAYLOAD_FILE
	string "Tianocore binary"
	default "payloads/external/tianocore/tianocore/Build/UEFIPAYLOAD.fd"
	help
	  The result of a UefiPayloadPkg build

choice
	prompt "Tianocore payload"
	default TIANOCORE_UEFIPAYLOAD
	help
	  Select which type of payload Tianocore will build (default is UefiPayload)
	  UefiPayload: MrChromebox's customized fork of Tianocore which works on most
	  x86_64 devices
	  Upstream: Use upstream Tianocore payload from https://github.com/tianocore/edk2

config TIANOCORE_UEFIPAYLOAD
	bool "UEFIPayload"
	help
	  Select this option to build using MrChromebox's custom Tianocore fork,
	  which incorporates fixes/improvements from System 76's and 9elements' trees.

config TIANOCORE_UPSTREAM
	bool "Upstream"
	help
	  Select this option if you want to use upstream EDK2 to build Tianocore.

endchoice

config TIANOCORE_REVISION_ID
	string "Insert a commit's SHA-1 or a branch name"
	help
	   The commit's SHA-1 or branch name of the revision to use. Choose "upstream/master"
	   for master branch of Tianocore release on github.

choice
	prompt "Tianocore build"
	default TIANOCORE_RELEASE
	help
	  Select whether to generate a debug or release build for
	  Tianocore; default is to generate a release build.

config TIANOCORE_DEBUG
	bool "Generate Tianocore debug build"
	help
	  Generate a debug build.

config TIANOCORE_RELEASE
	bool "Generate Tianocore release build"
	help
	  Generate a release build.

endchoice

if TIANOCORE_UEFIPAYLOAD

config TIANOCORE_CBMEM_LOGGING
	bool "Enable Tianocore logging to CBMEM"
	help
	  Select this option if you want to enable Tianocore logging to CBMEM.
	  You may want to increase the default cbmem buffer size when selecting
	  this option, especially if using a debug (vs release) build.
	  Selecting this option will increase the payload size in CBFS by ~220KB.

config TIANOCORE_BOOTSPLASH_IMAGE
	bool "Use a custom bootsplash image"
	help
	  Select this option if you have a bootsplash image that you would
	  like to be used. If this option is not selected, the default
	  coreboot logo (European Brown Hare) will used.

config TIANOCORE_BOOTSPLASH_FILE
	string "Tianocore Bootsplash path and filename"
	depends on TIANOCORE_BOOTSPLASH_IMAGE
	default "bootsplash.bmp"
	help
	  The path and filename of the file to use as graphical bootsplash
	  screen. The file format must be uncompressed BMP, and the file's
	  resolution must be less than the native resolution of the display.

	  If an absolute path is not given, the path will assumed to be
	  relative to the coreboot root directory.

config TIANOCORE_ABOVE_4G_MEMORY
	bool "Enable above 4G memory"
	default n
	help
	  Select this option to enable Above 4G Decode. This will allow the
	  payload to use all of the memory, rather than an maximum of 4G.

	  Disabling this option, which will reserve memory above 4G, is
	  useful for bootloaders that are not fully 64-bit aware such as
	  Qubes R4.0.4 bootloader.

endif

config TIANOCORE_BOOT_TIMEOUT
	int
	default 2
	help
	  The length of time in seconds for which the boot splash/menu prompt will be displayed.
	  For boards with an internal display, the default value of 2s is generally sufficient.
	  For boards without an internal display, a value of 5s is generally sufficient.


config TIANOCORE_ENABLE_IPXE
	bool "Include iPXE in Tianocore payload"
	default y
	help
	  Includes a prebuilt iPXE for EFI to the TianoCore payload.

config TIANOCORE_SECURE_BOOT
	bool "Enable TianoCore Secure Boot"
	depends on SMMSTORE_V2
	default n
	help
	  Enables UEFI Secure Boot image verification in TianoCore Payload.

config TIANOCORE_SATA_PASSWORD
	bool "Enable TianoCore SATA disk password"
	default n
	help
	  Enable SATA disk password suupport in the TianoCore payload.

config TIANOCORE_OPAL_PASSWORD
	bool "Enable TianoCore TCG OPAL password"
	default n
	help
	  Enables TCG OPAL disk password in the TianoCore Payload.

config TIANOCORE_BOOT_MENU_KEY
	hex "TianoCore boot menu key"
	default 0x0016
	help
	  Select the TianoCore payload boot menu key:
	  UP         0x0001
	  DOWN       0x0002
	  RIGHT      0x0003
	  LEFT       0x0004
	  HOME       0x0005
	  END        0x0006
	  INSERT     0x0007
	  DELETE     0x0008
	  F1         0x000B
	  F2         0x000C
	  F3         0x000D
	  F4         0x000E
	  F5         0x000F
	  F6         0x0010
	  F7         0x0011
	  F8         0x0012
	  F9         0x0013
	  F10        0x0014
	  F11        0x0015
	  F12        0x0016
	  ESC        0x0017

config TIANOCORE_SETUP_MENU_KEY
	hex "TianoCore setup menu key"
	default 0x0017
	help
	  Select the TianoCore payload setup menu key:
	  UP         0x0001
	  DOWN       0x0002
	  RIGHT      0x0003
	  LEFT       0x0004
	  HOME       0x0005
	  END        0x0006
	  INSERT     0x0007
	  DELETE     0x0008
	  F1         0x000B
	  F2         0x000C
	  F3         0x000D
	  F4         0x000E
	  F5         0x000F
	  F6         0x0010
	  F7         0x0011
	  F8         0x0012
	  F9         0x0013
	  F10        0x0014
	  F11        0x0015
	  F12        0x0016
	  ESC        0x0017

endif
```

## src/cpu/amd/Kconfig
```kconfig
source "src/cpu/amd/agesa/Kconfig"
source "src/cpu/amd/family_10h-family_15h/Kconfig"
source "src/cpu/amd/pi/Kconfig"
source "src/cpu/amd/socket_G34/Kconfig"
```

## src/cpu/amd/pi/Kconfig
```kconfig
# SPDX-License-Identifier: GPL-2.0-only

config CPU_AMD_PI
	bool
	default y if CPU_AMD_PI_00730F01
	default n
	select ARCH_X86
	select DRIVERS_AMD_PI
	select TSC_SYNC_LFENCE
	select UDELAY_LAPIC
	select LAPIC_MONOTONIC_TIMER
	select SPI_FLASH if HAVE_ACPI_RESUME
	select SMM_TSEG
	select PARALLEL_MP_AP_WORK
	select SOC_AMD_COMMON_BLOCK_SMM
	select SOC_AMD_COMMON_BLOCK_SMI
	select SOC_AMD_COMMON_BLOCK_ACPI
	select SSE2

if CPU_AMD_PI

config UDELAY_LAPIC_FIXED_FSB
	int
	default 200

# TODO: Sync these with definitions in PI vendorcode.
# DCACHE_RAM_BASE must equal BSP_STACK_BASE_ADDR.
# DCACHE_RAM_SIZE must equal BSP_STACK_SIZE.

config DCACHE_RAM_BASE
	hex
	default 0x30000

config DCACHE_RAM_SIZE
	hex
	default 0x10000

config DCACHE_BSP_STACK_SIZE
	hex
	default 0x4000

config SMM_MODULE_STACK_SIZE
	default 0x800

config SMM_TSEG_SIZE
	default 0x100000 if HAVE_SMI_HANDLER
	default 0x0

endif # CPU_AMD_PI

source "src/cpu/amd/pi/00730F01/Kconfig"
```

## src/cpu/intel/model_f3x/Kconfig
```kconfig
config CPU_INTEL_MODEL_F3X
	bool
	select ARCH_X86
	select SUPPORT_CPU_UCODE_IN_CBFS
	select CPU_INTEL_COMMON
	select SSE2
	select X86_LEGACY_SAVE_STATE
	select X86_EM64T101_SAVE_STATE
```

## src/cpu/intel/model_f4x/Kconfig
```kconfig
config CPU_INTEL_MODEL_F4X
	bool
	select ARCH_X86
	select SUPPORT_CPU_UCODE_IN_CBFS
	select SSE2
	select X86_EM64T101_SAVE_STATE
```

## src/cpu/intel/socket_441/Kconfig
```kconfig
config CPU_INTEL_SOCKET_441
	bool
	select CPU_INTEL_MODEL_106CX
	select SETUP_XIP_CACHE
	select X86_EM64T101_SAVE_STATE

if CPU_INTEL_SOCKET_441

config DCACHE_RAM_BASE
	hex
	default 0xfefc0000

config DCACHE_RAM_SIZE
	hex
	default 0x8000

config DCACHE_BSP_STACK_SIZE
	hex
	default 0x2000

endif # CPU_INTEL_SOCKET_441
```

## src/cpu/intel/socket_m/Kconfig
```kconfig
config CPU_INTEL_SOCKET_M
	bool
	select CPU_INTEL_MODEL_6EX
	select CPU_INTEL_MODEL_6FX
	select MMX
	select SSE
	select X86_LEGACY_SAVE_STATE
	select X86_EM64T101_SAVE_STATE

if CPU_INTEL_SOCKET_M

config DCACHE_RAM_BASE
	hex
	default 0xfefc0000

config DCACHE_RAM_SIZE
	hex
	default 0x8000

config DCACHE_BSP_STACK_SIZE
	hex
	default 0x2000

endif
```

## src/cpu/power9/Kconfig.debug_cpu
```kconfig
config DEBUG_SCOM
	bool "Print SCOM accesses" if DEFAULT_CONSOLE_LOGLEVEL_8 || CONSOLE_OVERRIDE_LOGLEVEL
	default n
	help
	  This option enables SCOM debug messages.

	  Some accesses are time-critical or happen too often to be logged.
	  In such cases, '#define SKIP_SCOM_DEBUG' before first inclusion of
	  scom.h can be used to disable logging for a given file. Messages
	  are currently suppressed for CCS, MCBIST and I2C.
```

## src/device/dram/Kconfig
```kconfig
##
## This file is part of the coreboot project.
##
## This program is free software; you can redistribute it and/or modify
## it under the terms of the GNU General Public License as published by
## the Free Software Foundation; version 2 of the License.
##
## This program is distributed in the hope that it will be useful,
## but WITHOUT ANY WARRANTY; without even the implied warranty of
## MERCHANTABILITY or FITNESS FOR A PARTICULAR PURPOSE.  See the
## GNU General Public License for more details.
##

config USE_DDR4
	bool
	default n
	help
	  system supports DDR4 memory

config USE_DDR3
	bool
	default n
	help
	  system supports DDR3 memory

config USE_DDR2
	bool
	default n
	help
	  system supports DDR2 memory
```

## src/drivers/amd/hypertransport/Kconfig
```kconfig
## SPDX-License-Identifier: GPL-2.0-only

config DRIVERS_AMD_HYPERTRANSPORT
	def_bool n
```

## src/drivers/gfx/nvidia/optimus/Kconfig
```kconfig
config DRIVER_NVIDIA_OPTIMUS
	bool
	default n
	depends on HAVE_ACPI_TABLES
	select PMC_IPC_ACPI_INTERFACE
	help
	   NVIDIA Optimus driver for ULT platforms with a PMC IPC ACPI interface.
	   and graphics cards supporting Runtime D3 power management
```

## src/drivers/intel/dtbt/Kconfig
```kconfig
config DRIVERS_INTEL_DTBT
	def_bool n
	help
	  Support for discrete Thunderbolt controllers


if !PCIEXP_HOTPLUG

config PCIEXP_HOTPLUG_BUSES
	int
	default 42

config PCIEXP_HOTPLUG_MEM
	hex
	default 0xc200000

config PCIEXP_HOTPLUG_PREFETCH_MEM
	hex
	default 0x1c000000

config PCIEXP_HOTPLUG_IO
	hex
	default 0x1000

config PCIEXP_HOTPLUG_PREFETCH_MEM_ABOVE_4G
	bool
	depends on RESOURCE_ALLOCATOR_V4
	default y

endif
```

## src/drivers/nuvoton/nct3933/Kconfig
```kconfig
config DRIVERS_NUVOTON_NCT3933
	bool
	default n
	help
	  Driver for Nuvoton NCT3933 SMBus Sink/Source Current DAC
```

## src/ec/clevo/it5570/Kconfig
```kconfig
config EC_CLEVO_IT5570
	bool
	help
	  Clevo IT5570 EC

config EC_CLEVO_IT5570_RAM_BASE
	depends on EC_CLEVO_IT5570
	hex
	default 0xfe0b0100
	  The base of LPC window that maps the EC RAM to host memory space.
	  This is the ACPI address for EC RAM, the address programmed to registers
	  is always rounded to the nearest 64K.
```

## src/ec/system76/ec/Kconfig
```kconfig
## SPDX-License-Identifier: GPL-2.0-only

config EC_SYSTEM76_EC
	select EC_ACPI
	bool
	help
	  System76 EC

config EC_SYSTEM76_EC_BAT_THRESHOLDS
	depends on EC_SYSTEM76_EC
	bool
	default y

config EC_SYSTEM76_EC_DGPU
	depends on EC_SYSTEM76_EC
	bool
	default n

config EC_SYSTEM76_EC_OLED
	depends on EC_SYSTEM76_EC
	bool
	default n

config EC_SYSTEM76_EC_UPDATE
	depends on EC_SYSTEM76_EC
	bool "Update the embedded controller firmware"
	default n

config EC_SYSTEM76_EC_UPDATE_FILE
	depends on EC_SYSTEM76_EC_UPDATE
	string "Path to the EC update file"
	default "ec.rom"

config EC_SYSTEM76_EC_FLASH_SIZE
	hex
	default 0x20000

config RAMSTAGE_CBFS_CACHE_SIZE
	default 0x40000 if EC_SYSTEM76_EC_UPDATE
```

## src/mainboard/clevo/adl-p/Kconfig
```kconfig
config BOARD_CLEVO_ADLP_COMMON
	def_bool n
	select BOARD_ROMSIZE_KB_32768
	select DRIVERS_I2C_HID
	select DRIVERS_INTEL_PMC
	select DRIVERS_INTEL_USB4_RETIMER
	select EC_SYSTEM76_EC
	select EC_ACPI
	select HAVE_ACPI_TABLES
	select HAVE_ACPI_RESUME
	select HAVE_CMOS_DEFAULT
	select HAVE_OPTION_TABLE
	select INTEL_GMA_HAVE_VBT
	select INTEL_LPSS_UART_FOR_CONSOLE
	select MAINBOARD_HAS_TPM2
	select MEMORY_MAPPED_TPM
	select NO_UART_ON_SUPERIO
	select SOC_INTEL_ALDERLAKE_PCH_P
	select SOC_INTEL_COMMON_BLOCK_HDA_VERB
	select SOC_INTEL_CRASHLOG
	select SOC_INTEL_ENABLE_USB4_PCIE_RESOURCES
	select SPD_READ_BY_WORD
	select SYSTEM_TYPE_LAPTOP

config BOARD_CLEVO_NS50PU_BASE
	bool
	select BOARD_CLEVO_ADLP_COMMON
	select DRIVERS_GENERIC_BAYHUB_LV2

config BOARD_CLEVO_NS50PU
	bool
	select BOARD_CLEVO_NS50PU_BASE

config BOARD_CLEVO_NV40PZ_BASE
	bool
	select BOARD_CLEVO_ADLP_COMMON
	select EC_SYSTEM76_EC_DGPU
	select DRIVERS_GENERIC_BAYHUB_LV2

config BOARD_CLEVO_NV40PZ
	bool
	select BOARD_CLEVO_NV40PZ_BASE

if BOARD_CLEVO_ADLP_COMMON

config MAINBOARD_DIR
	default "clevo/adl-p"

config VARIANT_DIR
	default "ns50pu" if BOARD_CLEVO_NS50PU_BASE
	default "nv40pz" if BOARD_CLEVO_NV40PZ_BASE

config OVERRIDE_DEVICETREE
	default "variants/\$(CONFIG_VARIANT_DIR)/overridetree.cb"

config MAINBOARD_PART_NUMBER
	default "ns50pu" if BOARD_CLEVO_NS50PU_BASE
	default "nv40pz" if BOARD_CLEVO_NV40PZ_BASE

config MAINBOARD_SMBIOS_PRODUCT_NAME
	default "NS5x_NS7xPU" if BOARD_CLEVO_NS50PU_BASE
	default "NV4xPZ" if BOARD_CLEVO_NV40PZ_BASE

config MAINBOARD_SMBIOS_MANUFACTURER
	default "Notebook"

config MAINBOARD_VERSION
	default "ns50pu" if BOARD_CLEVO_NS50PU_BASE
	default "nv40pz" if BOARD_CLEVO_NV40PZ_BASE

config MAINBOARD_FAMILY
	string
	default "Not Applicable" # Match stock firmware

config CBFS_SIZE
	default 0xA00000

config CONSOLE_POST
	default y

config DIMM_SPD_SIZE
	default 512

config ONBOARD_VGA_IS_PRIMARY
	default y

config POST_DEVICE
	default n

config UART_FOR_CONSOLE
	default 0

# PM Timer Disabled, saves power
config USE_PM_ACPI_TIMER
	default n

config VBOOT
	select GBB_FLAG_DISABLE_EC_SOFTWARE_SYNC
	select GBB_FLAG_DISABLE_FWMP
	select GBB_FLAG_DISABLE_LID_SHUTDOWN
	select GBB_FLAG_DISABLE_PD_SOFTWARE_SYNC
	select HAS_RECOVERY_MRC_CACHE
	select VBOOT_ALWAYS_ENABLE_DISPLAY
	select VBOOT_CLEAR_RECOVERY_IN_RAMSTAGE
	select VBOOT_MOCK_SECDATA
	select VBOOT_NO_BOARD_SUPPORT

config VBOOT_SLOTS_RW_A
	default y if VBOOT

config VBOOT_VBNV_OFFSET
	default 0x28

config FMDFILE
	default "src/mainboard/\$(CONFIG_MAINBOARD_DIR)/vboot-rwa.fmd" if VBOOT && VBOOT_SLOTS_RW_A

config TPM_PIRQ
	default 0x27 # GPP_E1

config SOC_INTEL_CSE_SEND_EOP_EARLY
	default n

config VBOOT_FWID_VERSION
	default "\$(CONFIG_LOCALVERSION)"

if PAYLOAD_EDK2

config EDK2_CPU_THROTTLING_THRESHOLD_DEFAULT
	default 20

endif

endif
```

## src/mainboard/clevo/adl-p/Kconfig.name
```kconfig
comment "Alder Lake P"

config BOARD_CLEVO_NS50PU
	bool "NS5xPU / NS7xPU"

config BOARD_CLEVO_NV40PZ
	bool "NV4xPZ"
```
